// Public fixtures generated by the pinned official Pearl node, not the firmware.
#include "BitcoinTransaction.h"
#include "BitcoinReview.h"
#include "ChainCommon.h"
#include "WalletCatalog.h"
#include "WalletCustody.h"
#include <cstdio>
#include <cstring>
#include <fstream>
#include <stdexcept>
#include <string>
#include <vector>
using namespace hexwallet;
using Bytes = std::vector<uint8_t>;
static unsigned checks = 0, failures = 0;
static void check(const char *name, bool ok)
{
  ++checks;
  failures += !ok;
  std::printf("%s: %s\n", name, ok ? "PASS" : "FAIL");
}
static Bytes hex(const std::string &s)
{
  if (s.empty() || s.size() % 2)
    throw std::runtime_error("hex length");
  Bytes out(s.size() / 2);
  size_t n = 0;
  if (!chain_parse_hex(s.c_str(), out.data(), out.size(), &n) || n != out.size())
    throw std::runtime_error("hex");
  return out;
}
static Bytes le(uint64_t n, unsigned count)
{
  Bytes out;
  while (count--)
  {
    out.push_back(uint8_t(n));
    n >>= 8;
  }
  return out;
}
static void append(Bytes &out, const Bytes &value) { out.insert(out.end(), value.begin(), value.end()); }
static void field(Bytes &out, const Bytes &key, const Bytes &value)
{
  if (key.empty() || key.size() >= 253 || value.size() >= 253)
    throw std::runtime_error("field");
  out.push_back(uint8_t(key.size()));
  append(out, key);
  out.push_back(uint8_t(value.size()));
  append(out, value);
}
struct Vector
{
  unsigned change;
  uint64_t value;
  std::string address;
  Bytes pub, script, tx, digest[2], signed_tx[2];
};
static Bytes fixture(const Vector &v, const Bytes &fingerprint, bool v2, unsigned hash,
                     uint32_t coin = 808276, bool output_derivation = true)
{
  Bytes b = {'p', 's', 'b', 't', 255};
  if (v2)
  {
    field(b, {251}, le(2, 4));
    field(b, {2}, le(2, 4));
    field(b, {4}, {1});
    field(b, {5}, {1});
  }
  else
    field(b, {0}, v.tx);
  b.push_back(0);
  Bytes utxo = le(v.value, 8);
  utxo.push_back(uint8_t(v.script.size()));
  append(utxo, v.script);
  field(b, {1}, utxo);
  field(b, {3}, le(hash, 4));
  Bytes derivation = {0};
  append(derivation, fingerprint);
  for (uint32_t step : {0x80000056U, coin | 0x80000000U, 0x80000000U, uint32_t(v.change), 0U})
    append(derivation, le(step, 4));
  Bytes internal(v.pub.begin() + 1, v.pub.end()), key = {0x16};
  append(key, internal);
  field(b, key, derivation);
  field(b, {0x17}, internal);
  if (v2)
  {
    field(b, {14}, Bytes(32, 0x42));
    field(b, {15}, le(0, 4));
    field(b, {16}, le(0xfffffffd, 4));
  }
  b.push_back(0);
  if (v2)
  {
    field(b, {3}, le(v.value - 1000, 8));
    field(b, {4}, v.script);
  }
  if (output_derivation)
  {
    key[0] = 7;
    field(b, key, derivation);
    field(b, {5}, internal);
  }
  b.push_back(0);
  return b;
}
int main(int argc, char **argv)
{
  if (argc != 2)
    return 2;
  try
  {
    std::ifstream file(argv[1]);
    std::string format, seed_hex, fingerprint_hex;
    file >> format >> seed_hex >> fingerprint_hex;
    if (format != "pearl-keypath-v1")
      throw std::runtime_error("fixture header");
    Bytes seed = hex(seed_hex), fingerprint = hex(fingerprint_hex);
    if (seed.size() != 32 || fingerprint.size() != 4)
      throw std::runtime_error("fixture seed");
    HdPrivateNode master = {};
    if (hd_private_from_seed(seed.data(), seed.size(), &master) != WalletError::Ok)
      return 2;
    const auto *network = find_network_profile("prl");
    const auto *policy = find_network_signing_policy("prl");
    if (!network || !policy)
      throw std::runtime_error("Pearl registry");
    const BitcoinChainParams chain = {network->id, nullptr, network->utxo, policy->family, policy->fork_id};
    WalletCatalogEntry entry = {};
    check("Pearl key-path catalog scope", wallet_catalog_find("prl", &entry) &&
                                              wallet_catalog_has(entry, WalletCapabilitySigning) && strstr(entry.status, "no P2MR"));
    check("Pearl custody remains MCU", key_scheme_for(*network) == KeyScheme::TaprootSchnorr &&
                                           !plan_key_custody(*network, se051c2hq1_profile()).se_can_sign);
    unsigned count = 0;
    Vector v;
    std::string pub, script, tx, d0, s0, d1, s1;
    while (file >> v.change >> v.value >> v.address >> pub >> script >> tx >> d0 >> s0 >> d1 >> s1)
    {
      ++count;
      v.pub = hex(pub);
      v.script = hex(script);
      v.tx = hex(tx);
      v.digest[0] = hex(d0);
      v.digest[1] = hex(d1);
      v.signed_tx[0] = hex(s0);
      v.signed_tx[1] = hex(s1);
      if (v.pub.size() != 33 || v.script.size() != 34 || v.digest[0].size() != 32 || v.digest[1].size() != 32)
        throw std::runtime_error("fixture dimensions");
      DerivedAddress address = {};
      uint8_t derived_public[33] = {};
      check("Pearl official derived address", derive_address(master, nullptr, *network, 0, v.change, 0, &address) == WalletError::Ok &&
                                                  v.address == address.address && public_key_from_private(address.private_key, derived_public) == WalletError::Ok &&
                                                  !memcmp(derived_public, v.pub.data(), 33));
      clear_derived_address(&address);
      for (bool v2 : {false, true})
        for (unsigned hash : {0U, 1U})
        {
          Bytes psbt = fixture(v, fingerprint, v2, hash);
          BitcoinSigningRequest req = {};
          bool parsed = bitcoin_parse_psbt(psbt.data(), psbt.size(), master, chain, &req) == TransactionError::Ok;
          check("Pearl PSBT review/ownership/fee", parsed && req.fee == 1000 && req.outputs[0].wallet_owned &&
                                                       req.outputs[0].change == (v.change == 1) && v.address == req.outputs[0].address);
          BitcoinReviewText text = {};
          WalletUiTransactionReview review = {};
          const char *expected_amount = v.value == 100000 ? "0.00099 PRL" :
            v.value == 2100000000000001ULL ? "20999999.99999001 PRL" : "20999999999.99999 PRL";
          check("Pearl device review uses PRL and grains", parsed && bitcoin_prepare_review(req, &text, &review) &&
            review.output_count == 1 && !strcmp(review.outputs[0].amount_text, expected_amount) &&
            !strncmp(review.fee_text, "0.00001 PRL | ", 13) && strstr(review.fee_text, "grain/vB") &&
            !strcmp(review.fee_label, "FEE"));
          uint8_t digest[32];
          check("Pearl official BIP341 digest", parsed &&
                                                    bitcoin_sighash_taproot(req, 0, uint8_t(hash), nullptr, 0, digest) == TransactionError::Ok &&
                                                    !memcmp(digest, v.digest[hash].data(), 32));
          uint8_t signed_tx[512];
          size_t size = sizeof(signed_tx);
          check("Pearl official complete signed transaction", parsed &&
                                                                  bitcoin_sign_request(req, master, signed_tx, &size) == TransactionError::Ok &&
                                                                  size == v.signed_tx[hash].size() && !memcmp(signed_tx, v.signed_tx[hash].data(), size));
          if (parsed)
          {
            req.chain.network_id = "btc86";
            req.chain.address = kBitcoinMainnet;
            size = sizeof(signed_tx);
            check("Pearl request cannot sign as Bitcoin", bitcoin_sign_request(req, master, signed_tx, &size) != TransactionError::Ok);
          }
        }
      for (bool v2 : {false, true})
      {
        BitcoinSigningRequest req = {};
        Bytes psbt = fixture(v, fingerprint, v2, 0, 0);
        check("Pearl rejects Bitcoin coin type", bitcoin_parse_psbt(psbt.data(), psbt.size(), master, chain, &req) != TransactionError::Ok);
        psbt = fixture(v, fingerprint, v2, 0);
        BitcoinChainParams wrong = chain;
        wrong.network_id = "btc86";
        wrong.address = kBitcoinMainnet;
        check("Bitcoin rejects Pearl path", bitcoin_parse_psbt(psbt.data(), psbt.size(), master, wrong, &req) != TransactionError::Ok);
        wrong = chain;
        wrong.address.bech32_hrp = "bc";
        check("Pearl rejects substituted address network", bitcoin_parse_psbt(psbt.data(), psbt.size(), master, wrong, &req) != TransactionError::Ok);
        for (unsigned unsafe_hash : {2U, 3U, 0x81U, 0x82U, 0x83U})
        {
          psbt = fixture(v, fingerprint, v2, unsafe_hash);
          check("Pearl rejects partial output commitments", bitcoin_parse_psbt(psbt.data(), psbt.size(), master, chain, &req) != TransactionError::Ok);
        }
      }
      Vector bad = v;
      bad.value = 2100000000000000001ULL;
      Bytes psbt = fixture(bad, fingerprint, true, 0);
      BitcoinSigningRequest req = {};
      check("Pearl rejects amount beyond MaxGrain", bitcoin_parse_psbt(psbt.data(), psbt.size(), master, chain, &req) == TransactionError::InvalidAmount);
      bad = v;
      bad.script[0] = 0x52;
      psbt = fixture(bad, fingerprint, true, 0);
      check("Pearl rejects unimplemented witness version", bitcoin_parse_psbt(psbt.data(), psbt.size(), master, chain, &req) != TransactionError::Ok);
    }
    check("six complete official oracle cases", count == 6 && file.eof());
    BitcoinSigningRequest invalid = {};
    BitcoinReviewText text = {};
    WalletUiTransactionReview review = {};
    check("empty review cannot approve", !bitcoin_prepare_review(invalid, &text, &review));
    invalid.chain = chain;
    invalid.output_count = kBitcoinMaxOutputs + 1;
    invalid.estimated_vbytes = 100;
    check("review never truncates outputs", !bitcoin_prepare_review(invalid, &text, &review));
    secure_zero(&master, sizeof(master));
    printf("%u checks, %u failures\n", checks, failures);
    return failures ? 1 : 0;
  }
  catch (const std::exception &e)
  {
    fprintf(stderr, "fixture error: %s\n", e.what());
    return 2;
  }
}
