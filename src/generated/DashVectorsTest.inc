// Pinned Dash vectors. Provenance, in order of strength:
//
//  * The two mainnet transactions are real chain data. Their on-chain
//    signatures verify against the digest this firmware computes from the same
//    bytes, which is what pins the serialization and the legacy sighash to
//    what Dash actually does rather than to my reading of it.
//  * The self-test request and its signature were produced offline with an
//    independent RFC 6979 implementation and are reproduced here as fixed
//    bytes; the device has to match them with mbedtls, so the two
//    implementations have to agree on every byte.
//
// The file is data only: nothing in the build regenerates it, and every value
// in it is checked by run_dash_self_tests() / run_dash_signature_self_test().
//
// The two mainnet vectors are real chain data: the digest below is the
// one their on-chain signature verifies against, so the firmware
// serialization is pinned to money that moved, not to a recollection of
// how Dash Core is written. The third vector is a request this wallet
// can actually build; its signature was produced with RFC 6979 and has
// to come out identical on the device.

// v3 plain transaction, block 2563353.
  static const uint8_t kDashMainnetV3Transaction[] = {
    0x03, 0x00, 0x00, 0x00, 0x01, 0xfc, 0x2a, 0x0a, 0x53, 0x8d, 0x6d, 0x75, 0x9a, 0x06, 0x7c, 0x13,
    0xeb, 0x0f, 0x3f, 0x60, 0x9c, 0xdd, 0x58, 0xa6, 0x2d, 0x87, 0x8c, 0x54, 0x63, 0xcb, 0xb6, 0xbc,
    0xb0, 0xaf, 0xd9, 0xa0, 0xbe, 0x00, 0x00, 0x00, 0x00, 0x6b, 0x48, 0x30, 0x45, 0x02, 0x21, 0x00,
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    0x00, 0x00,
  };
  static const uint8_t kDashMainnetV3Script[] = {
    0x76, 0xa9, 0x14, 0x4b, 0xec, 0xc7, 0xb1, 0xf8, 0x00, 0xee, 0xe7, 0x59, 0xfb, 0xd1, 0x7c, 0x40,
    0x02, 0x64, 0xbd, 0xef, 0xf5, 0xf4, 0x72, 0x88, 0xac,
  };
  static const uint8_t kDashMainnetV3Digest[] = {
    0xb8, 0xd9, 0xdf, 0x9a, 0xc3, 0xfe, 0xd5, 0xd9, 0xc4, 0x9d, 0x9d, 0x68, 0x98, 0xf7, 0x93, 0x5f,
    0xbc, 0x70, 0x0d, 0xe2, 0x0c, 0xa3, 0x60, 0xdf, 0xb7, 0x52, 0x27, 0x6c, 0x0a, 0xdd, 0x0c, 0x57,
  };

// v2 plain transaction, block 2563352. Dash still relays v2 payments;
// the digest algorithm does not care, but the parser must accept both.
  static const uint8_t kDashMainnetV2Transaction[] = {
    0x02, 0x00, 0x00, 0x00, 0x01, 0x38, 0x28, 0xbc, 0xe6, 0xbb, 0x20, 0xc2, 0xba, 0x19, 0xc7, 0x79,
    0x45, 0xae, 0xb4, 0xd1, 0xa4, 0x9f, 0x08, 0x8f, 0xad, 0x49, 0xc0, 0x3e, 0x1c, 0x62, 0xc3, 0xbf,
    0xcd, 0x4a, 0xbd, 0x11, 0x28, 0x00, 0x00, 0x00, 0x00, 0x6a, 0x47, 0x30, 0x44, 0x02, 0x20, 0x76,
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    0x00,
  };
  static const uint8_t kDashMainnetV2Script[] = {
    0x76, 0xa9, 0x14, 0x19, 0x46, 0xcc, 0x98, 0x28, 0x24, 0xb8, 0x52, 0xde, 0x8b, 0x20, 0x71, 0x02,
    0x35, 0x87, 0x86, 0x2f, 0x8f, 0xeb, 0x49, 0x88, 0xac,
  };
  static const uint8_t kDashMainnetV2Digest[] = {
    0xc6, 0x47, 0xad, 0xb1, 0x74, 0x07, 0x91, 0x5d, 0x68, 0x81, 0x73, 0xc9, 0x89, 0x18, 0xe6, 0x85,
    0xeb, 0x24, 0xb5, 0xc3, 0x18, 0xdb, 0xf8, 0xbb, 0xe5, 0x69, 0x46, 0x1e, 0x6b, 0x4e, 0x12, 0x36,
  };

// Self-test request: m/44'/5'/0'/0/0 from the synthetic master
// (private key 01..20, chain code 80..9f). 1.5 DASH in, 0.4 DASH out,
// the rest back as change; 10 000 duffs of fee over 225 vbytes.
  static const uint8_t kDashSelfTestPayload[] = {
    0x44, 0x41, 0x53, 0x48, 0x00, 0x00, 0x00, 0x00, 0x01, 0x2d, 0x33, 0xf9, 0xa2, 0x10, 0x83, 0xb0,
    0xb8, 0x4c, 0x6c, 0xb9, 0x33, 0xab, 0x4b, 0x5e, 0x4f, 0x73, 0xf2, 0x0a, 0x3b, 0x68, 0xec, 0xb8,
    0x9c, 0xb4, 0x9c, 0x5b, 0xae, 0x51, 0x62, 0xfa, 0xd8, 0x00, 0x00, 0x00, 0x00, 0xfe, 0xff, 0xff,
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    0x1c, 0x58, 0x77, 0xb9, 0x89, 0xbf, 0x64, 0x02, 0x6e, 0x71, 0x68, 0x5a, 0xcd, 0x88, 0xac,
  };
  static const uint8_t kDashSelfTestVerifiedPayload[] = {
    0x44, 0x41, 0x53, 0x32, 0x00, 0x00, 0x00, 0x00, 0x01, 0x2d, 0x33, 0xf9, 0xa2, 0x10, 0x83, 0xb0,
    0xb8, 0x4c, 0x6c, 0xb9, 0x33, 0xab, 0x4b, 0x5e, 0x4f, 0x73, 0xf2, 0x0a, 0x3b, 0x68, 0xec, 0xb8,
    0x9c, 0xb4, 0x9c, 0x5b, 0xae, 0x51, 0x62, 0xfa, 0xd8, 0x00, 0x00, 0x00, 0x00, 0xfe, 0xff, 0xff,
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    0x5a, 0xcd, 0x88, 0xac, 0x00, 0x00, 0x00, 0x00,
  };
  static const uint8_t kDashSelfTestPrevious[] = {
    0x03, 0x00, 0x00, 0x00, 0x01, 0x00, 0x00, 0x00, 0x00, 0x00, 0x00, 0x00, 0x00, 0x00, 0x00, 0x00,
    0x00, 0x00, 0x00, 0x00, 0x00, 0x00, 0x00, 0x00, 0x00, 0x00, 0x00, 0x00, 0x00, 0x00, 0x00, 0x00,
    0x00, 0x00, 0x00, 0x00, 0x00, 0xff, 0xff, 0xff, 0xff, 0x02, 0x01, 0x01, 0xff, 0xff, 0xff, 0xff,
    0x01, 0x80, 0xd1, 0xf0, 0x08, 0x00, 0x00, 0x00, 0x00, 0x19, 0x76, 0xa9, 0x14, 0xa1, 0xe5, 0xc5,
    0x6f, 0x2e, 0x50, 0xe2, 0x1c, 0x58, 0x77, 0xb9, 0x89, 0xbf, 0x64, 0x02, 0x6e, 0x71, 0x68, 0x5a,
    0xcd, 0x88, 0xac, 0x00, 0x00, 0x00, 0x00,
  };
  static const uint8_t kDashSelfTestUnsigned[] = {
    0x03, 0x00, 0x00, 0x00, 0x01, 0x2d, 0x33, 0xf9, 0xa2, 0x10, 0x83, 0xb0, 0xb8, 0x4c, 0x6c, 0xb9,
    0x33, 0xab, 0x4b, 0x5e, 0x4f, 0x73, 0xf2, 0x0a, 0x3b, 0x68, 0xec, 0xb8, 0x9c, 0xb4, 0x9c, 0x5b,
    0xae, 0x51, 0x62, 0xfa, 0xd8, 0x00, 0x00, 0x00, 0x00, 0x00, 0xfe, 0xff, 0xff, 0xff, 0x02, 0x00,
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    0xac, 0x00, 0x00, 0x00, 0x00,
  };
  static const uint8_t kDashSelfTestDigest[] = {
    0x76, 0x8a, 0xad, 0x44, 0xea, 0x3a, 0x21, 0x7a, 0x7e, 0x7b, 0x48, 0xff, 0x2b, 0x11, 0x5d, 0xbc,
    0x29, 0xe3, 0x8e, 0x42, 0x16, 0x0b, 0x06, 0x56, 0x0f, 0x0e, 0xbb, 0x7d, 0xec, 0xe1, 0x24, 0x76,
  };
  static const uint8_t kDashSelfTestSigned[] = {
    0x03, 0x00, 0x00, 0x00, 0x01, 0x2d, 0x33, 0xf9, 0xa2, 0x10, 0x83, 0xb0, 0xb8, 0x4c, 0x6c, 0xb9,
    0x33, 0xab, 0x4b, 0x5e, 0x4f, 0x73, 0xf2, 0x0a, 0x3b, 0x68, 0xec, 0xb8, 0x9c, 0xb4, 0x9c, 0x5b,
    0xae, 0x51, 0x62, 0xfa, 0xd8, 0x00, 0x00, 0x00, 0x00, 0x6a, 0x47, 0x30, 0x44, 0x02, 0x20, 0x3e,
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    0x89, 0xbf, 0x64, 0x02, 0x6e, 0x71, 0x68, 0x5a, 0xcd, 0x88, 0xac, 0x00, 0x00, 0x00, 0x00,
  };
  static const uint8_t kDashSelfTestPublicKey[] = {
    0x02, 0xd8, 0x7a, 0x63, 0x05, 0x3b, 0x05, 0xbd, 0x7b, 0xc0, 0x1c, 0x36, 0x87, 0x59, 0xa3, 0x2e,
    0x94, 0xcb, 0x7a, 0x3d, 0x06, 0xb2, 0x79, 0x79, 0xb1, 0xbf, 0xcb, 0x5a, 0xf3, 0xe9, 0x97, 0x8a,
    0xd2,
  };
  static const char kDashSelfTestAddress[] = "XqSssvV2xpD7cWmJEXKbLfbZS17nNCyLAm";
  static const char kDashSelfTestExternalAddress[] = "7VX8ctLrBuowG8KLCJWQh2KptUMgkakeuY";
  static const uint64_t kDashSelfTestFee = 10000ULL;
  static const uint32_t kDashSelfTestVbytes = 225;
