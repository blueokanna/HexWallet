// Generated by tools/generate_mining_catalog.py; do not edit.
// Active, explicitly mapped native assets only. Capability comes from WalletCatalog.
  {"AEGS", "Aegisum", "Scrypt", MiningCoinType::Asic, "aegisum", "fork_utxo_aegisum"},
  {"AUR", "Auroracoin", "Myriad-Groestl", MiningCoinType::Asic, "auroracoin-groestl", "fork_auroracoin"},
  {"AUR", "Auroracoin", "Qubit", MiningCoinType::Asic, "auroracoin-qubit", "fork_auroracoin"},
  {"AUR", "Auroracoin", "Scrypt", MiningCoinType::Asic, "auroracoin-scrypt", "fork_auroracoin"},
  {"AUR", "Auroracoin", "SHA-256", MiningCoinType::Asic, "auroracoin-sha", "fork_auroracoin"},
  {"AUR", "Auroracoin", "Skein", MiningCoinType::Asic, "auroracoin-skein", "fork_auroracoin"},
  {"AVS", "Aves", "Ethash", MiningCoinType::Asic, "aves", "avs"},
  {"AXE", "Axe", "X11", MiningCoinType::Asic, "axerunners", "axe"},
  {"B1T", "Bit", "Scrypt & AuxPoW", MiningCoinType::Asic, "bit", "fork_utxo_bit"},
  {"BTC", "Bitcoin", "SHA256", MiningCoinType::Asic, "bitcoin", "btc"},
  {"BCH", "Bitcoin Cash", "SHA256", MiningCoinType::Asic, "bitcoincash", "bch"},
  {"BSV", "Bitcoin SV", "SHA256", MiningCoinType::Asic, "bitcoinsv", "bsv"},
  {"BTN", "Bitnet Money", "Ethash", MiningCoinType::Asic, "bitnetmoney", "btn"},
  {"CAU", "Canxium", "Ethash", MiningCoinType::Asic, "canxium", "cau"},
  {"CHTA", "Cheetahcoin", "SHA256", MiningCoinType::Asic, "cheetahcoin", "fork_utxo_cheetahcoin"},
  {"CY", "Cyberyen", "Scrypt & AuxPoW", MiningCoinType::Asic, "cyberyen", "fork_utxo_cyberyen"},
  {"DASH", "Dash", "X11", MiningCoinType::Asic, "dash", "dash"},
  {"DGB", "DigiByte", "Qubit", MiningCoinType::Asic, "digibyte-qubit", "dgb"},
  {"DGB", "DigiByte", "Scrypt", MiningCoinType::Asic, "digibyte-scrypt", "dgb"},
  {"DGB", "DigiByte", "SHA-256", MiningCoinType::Asic, "digibyte-sha", "dgb"},
  {"DGB", "DigiByte", "Skein", MiningCoinType::Asic, "digibyte-skein", "dgb"},
  {"DGC", "DigitalCoin", "Scrypt", MiningCoinType::Asic, "digitalcoin-scrypt", "fork_digitalcoin"},
  {"DGC", "DigitalCoin", "SHA-256", MiningCoinType::Asic, "digitalcoin-sha", "fork_digitalcoin"},
  {"DGC", "DigitalCoin", "X11", MiningCoinType::Asic, "digitalcoin-x11", "fork_digitalcoin"},
  {"DOGE", "Dogecoin", "Scrypt & AuxPoW", MiningCoinType::Asic, "dogecoin", "doge"},
  {"DSV", "Doriancoin", "Scrypt", MiningCoinType::Asic, "doriancoin", "fork_utxo_doriancoin"},
  {"EFL", "e-Gulden", "Scrypt", MiningCoinType::Asic, "egulden", "fork_egulden"},
  {"XEC", "eCash", "SHA256", MiningCoinType::Asic, "ecash", "xec"},
  {"EMC2", "Einsteinium", "Scrypt", MiningCoinType::Asic, "einsteinium", "fork_einsteinium"},
  {"ETC", "Ethereum Classic", "Ethash", MiningCoinType::Asic, "ethereumclassic", "etc"},
  {"ETHW", "EthereumPOW", "Ethash", MiningCoinType::Asic, "ethereumpow", "ethw"},
  {"ETHO", "Etho Protocol", "Ethash", MiningCoinType::Asic, "etho", "etho"},
  {"EGAZ", "Etica", "Ethash", MiningCoinType::Asic, "etica", "egaz"},
  {"FLO", "FlorinCoin", "Scrypt", MiningCoinType::Asic, "florincoin", "fork_utxo_florincoin"},
  {"FXTC", "FxTC", "Scrypt", MiningCoinType::Asic, "fxtc-scrypt", "fork_utxo_fxtc"},
  {"FXTC", "FxTC", "SHA-256", MiningCoinType::Asic, "fxtc-sha", "fork_utxo_fxtc"},
  {"FXTC", "FxTC", "X11", MiningCoinType::Asic, "fxtc-x11", "fork_utxo_fxtc"},
  {"JKC", "Junkcoin", "Scrypt & AuxPoW", MiningCoinType::Asic, "junkcoin", "fork_utxo_junkcoin"},
  {"LRS", "Larissa Coin", "Ethash", MiningCoinType::Asic, "larissa", "lrs"},
  {"LBC", "LBRY Credits", "Various Algo", MiningCoinType::Asic, "lbry", "fork_lbry"},
  {"LTC", "Litecoin", "Scrypt & AuxPoW", MiningCoinType::Asic, "litecoin", "ltc"},
  {"MAZA", "MazaCoin", "SHA-256", MiningCoinType::Asic, "mazacoin-sha", "fork_maza"},
  {"MONA", "Monacoin", "Various Algo", MiningCoinType::Asic, "monacoin", "fork_monacoin"},
  {"MOON", "MoonCoin", "Scrypt & AuxPoW", MiningCoinType::Asic, "mooncoin", "fork_utxo_mooncoin"},
  {"MYDOGE", "Mydogecoin", "Scrypt & AuxPoW", MiningCoinType::Asic, "mydogecoin", "fork_utxo_mydogecoin"},
  {"XMY", "Myriad", "Myriad-Groestl", MiningCoinType::Asic, "myriad-groestl", "fork_myriadcoin"},
  {"XMY", "Myriad", "Scrypt", MiningCoinType::Asic, "myriad-scrypt", "fork_myriadcoin"},
  {"MYT", "Mytherra", "SHA256", MiningCoinType::Asic, "mytherra", "fork_utxo_mytherra"},
  {"CKB", "Nervos Network", "Various Algo", MiningCoinType::Asic, "nervos", "ckb"},
  {"NENG", "NewEnglandCoin", "Scrypt & AuxPoW", MiningCoinType::Asic, "newenglandcoin", "fork_utxo_newenglandcoin"},
  {"NYC", "NewYorkCoin", "Scrypt & AuxPoW", MiningCoinType::Asic, "newyorkcoin", "fork_newyorkc"},
  {"OCTA", "OctaSpace", "Ethash", MiningCoinType::Asic, "octaspace", "octa"},
  {"OSMI", "Osmium", "X11", MiningCoinType::Asic, "osmium", "fork_utxo_osmium"},
  {"PLM", "Palladium", "SHA256", MiningCoinType::Asic, "palladium", "fork_utxo_palladium"},
  {"QUAI", "Quai", "Scrypt", MiningCoinType::Asic, "quai-scrypt", "quai"},
  {"QUAI", "Quai", "SHA-256", MiningCoinType::Asic, "quai-sha", "quai"},
  {"QRK", "QuarkCoin", "Groestl | Qubit | Skein | Quark", MiningCoinType::Asic, "quarkcoin", "fork_utxo_quarkcoin"},
  {"SHIC", "ShibaCoin", "Scrypt & AuxPoW", MiningCoinType::Asic, "shibacoin", "fork_utxo_shibacoin"},
  {"SC", "Siacoin", "Various Algo", MiningCoinType::Asic, "siacoin", "sc"},
  {"ROGER", "TheHolyRogerCoin", "Scrypt", MiningCoinType::Asic, "theholyroger", "fork_utxo_theholyrogercoin"},
  {"TRMP", "TrumPOW", "Scrypt & AuxPoW", MiningCoinType::Asic, "trumpow", "fork_utxo_trumpow"},
  {"VBC", "VirBiCoin", "Ethash", MiningCoinType::Asic, "virbicoin", "vbc"},
  {"WJK", "Wojakcoin", "SHA256", MiningCoinType::Asic, "wojakcoin", "fork_utxo_wojakcoin"},
  {"ZEC", "Zcash", "Equihash", MiningCoinType::Asic, "zcash", "zec"},
  {"BBC", "Babacoin", "GhostRider", MiningCoinType::Cpu, "babacoin", "fork_utxo_babacoin"},
  {"BELL", "Bellcoin", "YesPoWer", MiningCoinType::Cpu, "bellcoin", "fork_utxo_bellcoin"},
  {"BBP", "BiblePay", "RandomX Variants", MiningCoinType::Cpu, "biblepay", "fork_utxo_biblepay"},
  {"TAFT", "CoinTAFT", "GhostRider", MiningCoinType::Cpu, "cointaft", "fork_utxo_cointaft"},
  {"COSA", "Cosanta", "Various Algo", MiningCoinType::Cpu, "cosanta", "fork_utxo_cosanta"},
  {"DGB", "DigiByte", "Odocrypt", MiningCoinType::Cpu, "digibyte-odocrypt", "dgb"},
  {"DYN", "Dynamic", "Argon2d | Argon2i", MiningCoinType::Cpu, "dynamic", "fork_utxo_dynamic"},
  {"FSC", "Fsociety", "GhostRider", MiningCoinType::Cpu, "fsociety", "fork_utxo_fsociety"},
  {"JGC", "JagoanCoin", "GhostRider", MiningCoinType::Cpu, "jagoancoin", "fork_utxo_jagoancoin"},
  {"MAZA", "MazaCoin", "MinotaurX", MiningCoinType::Cpu, "mazacoin-minotaurx", "fork_maza"},
  {"XMR", "Monero", "RandomX Variants", MiningCoinType::Cpu, "monero", "xmr"},
  {"XMY", "Myriad", "Argon2d", MiningCoinType::Cpu, "myriad-argon2d", "fork_myriadcoin"},
  {"QRL", "Quantum R L", "RandomX Variants", MiningCoinType::Cpu, "quantumrl", "qrl"},
  {"RTM", "Raptoreum", "GhostRider", MiningCoinType::Cpu, "raptoreum", "fork_utxo_raptoreum"},
  {"SUGAR", "Sugarchain", "YesPoWer", MiningCoinType::Cpu, "sugarchain", "fork_sugarchain"},
  {"VEIL", "Veil", "RandomX", MiningCoinType::Cpu, "veil-randomx", "fork_utxo_veil"},
  {"VEIL", "Veil", "SHA256dv", MiningCoinType::Cpu, "veil-sha", "fork_utxo_veil"},
  {"VIPS", "VipStarCoin", "Various Algo", MiningCoinType::Cpu, "vipstarcoin", "fork_utxo_vipstarcoin"},
  {"WHIVE", "Whive", "YesPoWer", MiningCoinType::Cpu, "whive", "fork_utxo_whive"},
  {"ZEPH", "Zephyr", "RandomX Variants", MiningCoinType::Cpu, "zephyr", "zeph"},
  {"AE", "Aeternity", "ProgPoW | Cuckoo", MiningCoinType::Gpu, "aeternity", "ae"},
  {"ALPH", "Alephium", "Various Algo", MiningCoinType::Gpu, "alephium", "alph"},
  {"BTG", "Bitcoin Gold", "Equihash", MiningCoinType::Gpu, "bitcoingold", "btg"},
  {"BTX", "Bitcore", "Various Algo", MiningCoinType::Gpu, "bitcore", "fork_bitcore"},
  {"CHC", "Chaincoin", "PHI2 | C11 | HMQ1725", MiningCoinType::Gpu, "chaincoin", "fork_utxo_chaincoin"},
  {"DCR", "Decred", "Various Algo", MiningCoinType::Gpu, "decred", "dcr"},
  {"ERG", "Ergo", "Various Algo", MiningCoinType::Gpu, "ergo", "erg"},
  {"FTC", "Feathercoin", "NeoScrypt", MiningCoinType::Gpu, "feathercoin", "fork_feathercoin"},
  {"FXTC", "FxTC", "Lyra2z", MiningCoinType::Gpu, "fxtc-lyra2z", "fork_utxo_fxtc"},
  {"FXTC", "FxTC", "X16R", MiningCoinType::Gpu, "fxtc-x16r", "fork_utxo_fxtc"},
  {"GAEL", "Gaelium", "KawPow", MiningCoinType::Gpu, "gaelium", "fork_utxo_gaelium"},
  {"GRLC", "Garlicoin", "Allium | Tribus | bmw512", MiningCoinType::Gpu, "garlicoin", "fork_utxo_garlicoin"},
  {"BSTY", "GlobalBoost-Y", "Yescrypt", MiningCoinType::Gpu, "globalboost", "fork_utxo_globalboost-y"},
  {"GBX", "GoByte", "NeoScrypt", MiningCoinType::Gpu, "gobyte", "fork_gobyte"},
  {"HTH", "HelpTheHomeless", "X16R | X16Rv2 | X16RT | X16S", MiningCoinType::Gpu, "hthcoin", "fork_utxo_helpthehomeless"},
  {"KAS", "Kaspa", "kHeavyHash Variants", MiningCoinType::Gpu, "kaspa", "kas"},
  {"XMY", "Myriad", "Yescrypt", MiningCoinType::Gpu, "myriad-yescrypt", "fork_myriadcoin"},
  {"NBY", "Neobytes", "NeoScrypt", MiningCoinType::Gpu, "neobytes", "fork_utxo_neobytes"},
  {"NEOX", "Neoxa", "KawPow", MiningCoinType::Gpu, "neoxa", "fork_utxo_neoxa"},
  {"XNA", "Neurai", "KawPow", MiningCoinType::Gpu, "neurai", "fork_utxo_neurai"},
  {"QUAI", "Quai", "KawPow", MiningCoinType::Gpu, "quai-kawpow", "quai"},
  {"QTC", "Quantus", "Various Algo", MiningCoinType::Gpu, "quantus", "quantus"},
  {"RVN", "Ravencoin", "KawPow", MiningCoinType::Gpu, "ravencoin", "rvn"},
  {"RIN", "RinCoin", "Various Algo", MiningCoinType::Gpu, "rincoin", "fork_utxo_rincoin"},
  {"RITO", "Ritocoin", "X21S | X17 | X15 | X14 | X13", MiningCoinType::Gpu, "ritocoin", "fork_ritocoin"},
  {"RYO", "Ryo Currency", "CryptoNight Variants", MiningCoinType::Gpu, "ryo", "ryo"},
  {"SATOX", "SatoxCoin", "KawPow", MiningCoinType::Gpu, "satoxcoin", "fork_utxo_satoxcoin"},
  {"SCC", "StakeCubeCoin", "Various Algo", MiningCoinType::Gpu, "stakecubecoin", "fork_utxo_stakecubecoin"},
  {"UFO", "UFOCoin", "NeoScrypt", MiningCoinType::Gpu, "ufocoin", "fork_utxo_ufocoin"},
  {"VEIL", "Veil", "ProgPow", MiningCoinType::Gpu, "veil-progpow", "fork_utxo_veil"},
  {"VTC", "Vertcoin", "Various Algo", MiningCoinType::Gpu, "vertcoin", "vtc"},
  {"VIVO", "VIVO", "NeoScrypt", MiningCoinType::Gpu, "vivo", "fork_vivo"},
  {"ZANO", "Zano", "ProgPoW | Cuckoo", MiningCoinType::Gpu, "zano", "zano"},
  {"ZOC", "ZeroOneCoin", "NeoScrypt", MiningCoinType::Gpu, "zeroonecoin", "fork_utxo_zeroonecoin"},
  {"XCH", "Chia", "Proof of Capacity", MiningCoinType::Hdd, "chia", "xch"},
  {"XMY", "Myriad", "SHA-256", MiningCoinType::Merged, "myriad-sha", "fork_myriadcoin"},
  {"NMC", "Namecoin", "Merged mining", MiningCoinType::Merged, "namecoin", "nmc"},
