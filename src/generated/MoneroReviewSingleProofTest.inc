// Independent pinned Monero prover output for one 800000000000-atomic-unit output.
// Source: monero-project/monero v0.18.4.0 (f1311d4237404ab7da76241dbf10e92a65132cc4).
// The proof is test-only evidence; it is not generated by firmware.
{
{0xfc,0xa3,0x01,0xd1,0xbb,0xab,0x7b,0x3a,0x72,0xbd,0xc4,0x4e,0xcc,0x9b,0xc4,0xdd,0xbf,0x30,0x81,0xfe,0x1b,0x28,0xf0,0xe3,0x4d,0x37,0xf8,0x1c,0xa2,0x50,0xf2,0x30},
{0xf1,0x44,0x7f,0x06,0x8b,0xe7,0x42,0x20,0x26,0x42,0xa9,0xa8,0x08,0x61,0x53,0x37,0x39,0x7f,0xe7,0x6a,0x2e,0x36,0xcb,0x71,0xa9,0xc6,0xa0,0xaa,0x3b,0xb2,0x67,0x2b},
{0xc3,0x7c,0xb2,0x1e,0x76,0xd3,0x7c,0x72,0x31,0xc6,0x3f,0x0d,0x5b,0xbf,0x29,0x58,0x7c,0x77,0x3e,0x7c,0x30,0x8d,0x7a,0x06,0xe8,0xea,0x9b,0x83,0x75,0xad,0x4d,0xc4},
{0xe7,0x1e,0x95,0x9b,0x5d,0x68,0x32,0x34,0x6d,0x2f,0x63,0xe3,0xa2,0x95,0xdc,0xa9,0xa5,0x5b,0x85,0xa8,0x2b,0xe1,0xfe,0xf9,0xb3,0x19,0xd3,0x2b,0xa3,0x88,0x65,0x03},
{0x6a,0x8b,0x73,0x81,0xe4,0xa9,0xe2,0x1f,0x9f,0x65,0xf0,0xd9,0xe1,0x9b,0xdb,0x41,0xb8,0x85,0x18,0x12,0x50,0x88,0x84,0x3e,0xba,0x45,0xab,0x92,0x9d,0x44,0x2d,0x05},
{0xa5,0xa1,0x31,0xe1,0xa6,0x35,0x61,0x9f,0x95,0xc4,0x7a,0xf4,0x8e,0xf0,0xe5,0xba,0x08,0xfa,0x7b,0x24,0x80,0x50,0x06,0x57,0x1f,0xf4,0xca,0x27,0x3c,0xf2,0x5f,0x0f},
6, 6,
{
{0x8b,0x9f,0x4b,0xcc,0x8a,0x01,0xcd,0xde,0xb6,0x93,0x4a,0x86,0xc1,0x6e,0xc5,0xc8,0xd0,0x0b,0xf2,0x17,0xc9,0xd6,0x66,0xba,0xcd,0xf7,0xf6,0xeb,0x83,0x80,0x19,0xf3},
{0x86,0x3d,0xfe,0x46,0xf4,0xf5,0x54,0xfa,0xa2,0x2b,0xd0,0x9b,0x34,0x31,0x88,0x2f,0xe4,0x22,0x12,0x91,0x1c,0x95,0xa7,0x1a,0x41,0xab,0x19,0x9b,0xd3,0x2b,0xa5,0xe0},
{0x06,0x56,0x7f,0x26,0xa7,0xa3,0x66,0xad,0x3a,0x05,0x8d,0xd8,0x4c,0xd8,0xc0,0x2a,0x82,0x74,0x0c,0x69,0x35,0xfe,0x12,0xc2,0xb0,0x35,0x78,0x24,0x67,0xf1,0x91,0xaf},
{0x8f,0x2b,0x64,0x07,0x34,0xa2,0x6e,0xa7,0x89,0xa5,0x68,0x03,0x16,0xb0,0xa2,0x6e,0xdd,0x44,0x02,0x77,0xd6,0xc6,0x1b,0x74,0xb9,0x1f,0x23,0x4d,0xf3,0x75,0x69,0xcb},
{0xcc,0x0d,0x5b,0x08,0xdf,0xd1,0xc4,0x47,0x83,0x0d,0x2e,0x35,0x55,0x9d,0xa7,0xba,0x6a,0x95,0x8a,0x90,0xd9,0x77,0x34,0xa8,0xe1,0x16,0x09,0x98,0x70,0x45,0x5f,0xbd},
{0x1e,0xa5,0x8b,0x56,0xa8,0xd3,0x5c,0x43,0x27,0xd3,0x3b,0x5e,0x4f,0xbb,0x19,0x03,0x85,0xe7,0x76,0xbd,0x0c,0x51,0x0a,0xb8,0x59,0x33,0x19,0x42,0x45,0x59,0x06,0xb1},
},
{
{0x51,0xd8,0xf4,0x3e,0xde,0xb6,0xc6,0x30,0x21,0x10,0x4d,0xe9,0x7a,0x33,0x9f,0xd6,0x5b,0x4c,0x96,0x63,0x4c,0x8b,0x9e,0x75,0x23,0x94,0x74,0x48,0x92,0x88,0x3e,0x05},
{0xc4,0x4f,0x82,0xa6,0xb8,0x84,0xd4,0x1a,0x83,0xa9,0x18,0x6d,0x2b,0x18,0xab,0x9f,0x7d,0x5d,0x3b,0xd2,0x44,0xd4,0xac,0xfd,0xe3,0x8b,0x3a,0x29,0x41,0xd5,0xd7,0xca},
{0xf0,0x34,0xf3,0xc4,0x28,0x1a,0x15,0x7f,0x69,0x81,0x1a,0x2b,0x97,0x06,0x01,0x7f,0x5c,0x8a,0x89,0x7b,0xdf,0xb1,0x7f,0x05,0xb5,0xd7,0x03,0x9b,0xdd,0x28,0x89,0xf6},
{0xab,0x71,0xe5,0x11,0xcd,0x80,0xaf,0xaf,0xfb,0x15,0x56,0xb0,0xde,0x4d,0xc6,0xc7,0x06,0x1a,0xee,0x50,0x90,0x43,0x46,0xfe,0x8b,0xf7,0x8a,0x5f,0x85,0xb8,0x25,0x92},
{0xf5,0xd5,0x8e,0x6d,0xcf,0xb8,0x5e,0x30,0xb1,0x57,0x0a,0x99,0xe1,0x77,0x08,0x38,0x79,0x26,0x36,0x66,0x3f,0x1e,0x9e,0xad,0xcf,0x67,0x00,0x19,0xdb,0x20,0x27,0x1b},
{0x44,0x96,0xb9,0xe1,0x3a,0x4d,0x5f,0xfc,0xc4,0xab,0xd7,0x00,0x65,0xb5,0xa8,0x86,0xc1,0x4e,0x45,0x1c,0x8a,0xea,0x4d,0x8d,0x5a,0xa6,0x7c,0xcb,0x17,0x23,0x8e,0x10},
},
}
