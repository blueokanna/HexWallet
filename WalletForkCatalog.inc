// Generated by tools/generate_fork_profiles.py from tools/fork_registry.json.
// Base parameters imported from iancoleman/bip39; rows carrying a source
// field were cross-checked against the official chainparams.cpp. Native
// SegWit requires an official bech32 HRP; nested SegWit requires explicit
// segwit metadata from the same source.
// Sorted by chain name A-Z.
  {"fork_adcoin", "ACC", "Adcoin", 161, WalletCapabilityAddress, "fork_adcoin", "imported address metadata; no official chainparams review; signing unavailable"},
  {"fork_anon", "ANON", "ANON", 220, WalletCapabilityAddress, "fork_anon", "imported address metadata; no official chainparams review; signing unavailable"},
  {"fork_argentum-lyra", "ARG", "Argentum", 45, WalletCapabilityAddress, "fork_argentum-lyra", "official chainparams address parameters; signing policy is separate"},
  {"fork_argoneum", "AGM", "Argoneum", 421, WalletCapabilityAddress, "fork_argoneum", "official chainparams address parameters; signing policy is separate"},
  {"fork_artax", "XAX", "Artax", 219, WalletCapabilityAddress, "fork_artax", "imported address metadata; no official chainparams review; signing unavailable"},
  {"fork_aryacoin", "ARYA", "Aryacoin", 357, WalletCapabilityAddress, "fork_aryacoin", "imported address metadata; no official chainparams review; signing unavailable"},
  {"fork_asiacoin", "AC", "Asiacoin", 51, WalletCapabilityAddress, "fork_asiacoin", "imported address metadata; no official chainparams review; signing unavailable"},
  {"fork_auroracoin", "AUR", "Auroracoin", 85, WalletCapabilityAddress, "fork_auroracoin", "imported address metadata; no official chainparams review; signing unavailable"},
  {"fork_aurumcoin", "AU", "AurumCoin", 985, WalletCapabilityAddress, "fork_aurumcoin", "official chainparams address parameters; signing policy is separate"},
  {"fork_bata", "BTA", "Bata", 89, WalletCapabilityAddress, "fork_bata", "imported address metadata; no official chainparams review; signing unavailable"},
  {"fork_beetlecoin", "BEET", "Beetlecoin", 800, WalletCapabilityAddress, "fork_beetlecoin", "imported address metadata; no official chainparams review; signing unavailable"},
  {"fork_belacoin", "BELA", "Belacoin", 73, WalletCapabilityAddress, "fork_belacoin", "imported address metadata; no official chainparams review; signing unavailable"},
  {"fork_bitcloud", "BTDX", "BitCloud", 218, WalletCapabilityAddress, "fork_bitcloud", "imported address metadata; no official chainparams review; signing unavailable"},
  {"fork_bitcoindiamond", "BCD", "Bitcoin Diamond", 999, WalletCapabilityAddress, "fork_bitcoindiamond", "official chainparams address parameters; signing policy is separate"},
  {"fork_bitcoingreen", "BITG", "Bitcoin Green", 222, WalletCapabilityAddress, "fork_bitcoingreen", "imported address metadata; no official chainparams review; signing unavailable"},
  {"fork_bitcoinprivate", "BTCP", "Bitcoin Private", 183, WalletCapabilityAddress, "fork_bitcoinprivate", "imported address metadata; no official chainparams review; signing unavailable"},
  {"fork_bitcoinplus", "XBC", "Bitcoinplus", 65, WalletCapabilityAddress, "fork_bitcoinplus", "imported address metadata; no official chainparams review; signing unavailable"},
  {"fork_bitcoinz", "BTCZ", "Bitcoinz", 177, WalletCapabilityAddress, "fork_bitcoinz", "imported address metadata; no official chainparams review; signing unavailable"},
  {"fork_bitcore", "BTX", "Bitcore", 160, WalletCapabilityAddress, "fork_bitcore", "imported address metadata; no official chainparams review; signing unavailable"},
  {"fork_bitsend", "BSD", "Bitsend", 91, WalletCapabilityAddress, "fork_bitsend", "imported address metadata; no official chainparams review; signing unavailable"},
  {"fork_blackcoin", "BLK", "BlackCoin", 10, WalletCapabilityAddress, "fork_blackcoin", "imported address metadata; no official chainparams review; signing unavailable"},
  {"fork_blocknode", "BND", "Blocknode", 2941, WalletCapabilityAddress, "fork_blocknode", "imported address metadata; no official chainparams review; signing unavailable"},
  {"fork_blockstamp", "BST", "BlockStamp", 254, WalletCapabilityAddress, "fork_blockstamp", "imported address metadata; no official chainparams review; signing unavailable"},
  {"fork_bolivarcoin", "BOLI", "Bolivarcoin", 278, WalletCapabilityAddress, "fork_bolivarcoin", "imported address metadata; no official chainparams review; signing unavailable"},
  {"fork_britcoin", "BRIT", "Britcoin", 70, WalletCapabilityAddress, "fork_britcoin", "imported address metadata; no official chainparams review; signing unavailable"},
  {"fork_c0ban", "RYO", "c0ban", 382, WalletCapabilityAddress, "fork_c0ban", "official chainparams address parameters; signing policy is separate"},
  {"fork_campuscoin", "CC", "CampusCoin", 6767, WalletCapabilityAddress, "fork_campuscoin", "official chainparams address parameters; signing policy is separate"},
  {"fork_canadaecoin", "CDN", "Canadaecoin", 34, WalletCapabilityAddress, "fork_canadaecoin", "imported address metadata; no official chainparams review; signing unavailable"},
  {"fork_cannacoin", "CCN", "Cannacoin", 19, WalletCapabilityAddress, "fork_cannacoin", "imported address metadata; no official chainparams review; signing unavailable"},
  {"fork_ceilingcat", "CCC", "CeilingCatCoin", 702, WalletCapabilityAddress, "fork_ceilingcat", "official chainparams address parameters; signing policy is separate"},
  {"fork_clam", "CLAM", "Clams", 23, WalletCapabilityAddress, "fork_clam", "imported address metadata; no official chainparams review; signing unavailable"},
  {"fork_clubcoin", "CLUB", "Clubcoin", 79, WalletCapabilityAddress, "fork_clubcoin", "imported address metadata; no official chainparams review; signing unavailable"},
  {"fork_compcoin", "CMP", "Compcoin", 71, WalletCapabilityAddress, "fork_compcoin", "imported address metadata; no official chainparams review; signing unavailable"},
  {"fork_cpuchain", "CPU", "CPUchain", 363, WalletCapabilityAddress, "fork_cpuchain", "imported address metadata; no official chainparams review; signing unavailable"},
  {"fork_cranepay", "CRP", "CranePay", 2304, WalletCapabilityAddress, "fork_cranepay", "imported address metadata; no official chainparams review; signing unavailable"},
  {"fork_crave", "CRAVE", "Crave", 186, WalletCapabilityAddress, "fork_crave", "imported address metadata; no official chainparams review; signing unavailable"},
  {"fork_crown", "CRW", "Crown (Legacy)", 72, WalletCapabilityAddress, "fork_crown", "imported address metadata; no official chainparams review; signing unavailable"},
  {"fork_deeponion", "ONION", "DeepOnion", 305, WalletCapabilityAddress, "fork_deeponion", "imported address metadata; no official chainparams review; signing unavailable"},
  {"fork_defcoin", "DFC", "Defcoin", 1337, WalletCapabilityAddress, "fork_defcoin", "imported address metadata; no official chainparams review; signing unavailable"},
  {"fork_denarius", "DNR", "Denarius", 116, WalletCapabilityAddress, "fork_denarius", "imported address metadata; no official chainparams review; signing unavailable"},
  {"fork_diamond", "DMD", "Diamond", 152, WalletCapabilityAddress, "fork_diamond", "imported address metadata; no official chainparams review; signing unavailable"},
  {"fork_digitalcoin", "DGC", "Digitalcoin", 18, WalletCapabilityAddress, "fork_digitalcoin", "imported address metadata; no official chainparams review; signing unavailable"},
  {"fork_divi", "DIVI", "DIVI", 301, WalletCapabilityAddress, "fork_divi", "imported address metadata; no official chainparams review; signing unavailable"},
  {"fork_ecoin", "ECN", "Ecoin", 115, WalletCapabilityAddress, "fork_ecoin", "imported address metadata; no official chainparams review; signing unavailable"},
  {"fork_edrcoin", "EDRC", "Edrcoin", 56, WalletCapabilityAddress, "fork_edrcoin", "imported address metadata; no official chainparams review; signing unavailable"},
  {"fork_egulden", "EFL", "Egulden", 78, WalletCapabilityAddress, "fork_egulden", "imported address metadata; no official chainparams review; signing unavailable"},
  {"fork_einsteinium", "EMC2", "Einsteinium", 41, WalletCapabilityAddress, "fork_einsteinium", "imported address metadata; no official chainparams review; signing unavailable"},
  {"fork_elastos", "ELA", "Elastos", 2305, WalletCapabilityAddress, "fork_elastos", "imported address metadata; no official chainparams review; signing unavailable"},
  {"fork_energi", "NRG", "Energi", 204, WalletCapabilityAddress, "fork_energi", "imported address metadata; no official chainparams review; signing unavailable"},
  {"fork_europecoin", "ERC", "Europecoin", 151, WalletCapabilityAddress, "fork_europecoin", "imported address metadata; no official chainparams review; signing unavailable"},
  {"fork_evoai", "EVO", "EvoAI", 98, WalletCapabilityAddress, "fork_evoai", "official chainparams address parameters; signing policy is separate"},
  {"fork_evoai84", "EVO", "EvoAI Native SegWit", 98, WalletCapabilityAddress, "fork_evoai84", "official chainparams address parameters; signing policy is separate"},
  {"fork_evoai49", "EVO", "EvoAI Nested SegWit", 98, WalletCapabilityAddress, "fork_evoai49", "official chainparams address parameters; signing policy is separate"},
  {"fork_exclusivecoin", "EXCL", "Exclusivecoin", 190, WalletCapabilityAddress, "fork_exclusivecoin", "imported address metadata; no official chainparams review; signing unavailable"},
  {"fork_feathercoin", "FTC", "Feathercoin", 8, WalletCapabilityAddress, "fork_feathercoin", "imported address metadata; no official chainparams review; signing unavailable"},
  {"fork_firo", "FIRO", "Firo (Zcoin rebrand)", 136, WalletCapabilityAddress, "fork_firo", "imported address metadata; no official chainparams review; signing unavailable"},
  {"fork_firstcoin", "FRST", "Firstcoin", 167, WalletCapabilityAddress, "fork_firstcoin", "imported address metadata; no official chainparams review; signing unavailable"},
  {"fork_fix", "FIX", "FIX", 336, WalletCapabilityAddress, "fork_fix", "imported address metadata; no official chainparams review; signing unavailable"},
  {"fork_flashcoin", "FLASH", "Flashcoin", 120, WalletCapabilityAddress, "fork_flashcoin", "imported address metadata; no official chainparams review; signing unavailable"},
  {"fork_fujicoin", "FJC", "Fujicoin", 75, WalletCapabilityAddress, "fork_fujicoin", "imported address metadata; no official chainparams review; signing unavailable"},
  {"fork_game", "GAME", "GameCredits", 101, WalletCapabilityAddress, "fork_game", "imported address metadata; no official chainparams review; signing unavailable"},
  {"fork_gcr", "GCR", "GCRCoin", 79, WalletCapabilityAddress, "fork_gcr", "imported address metadata; no official chainparams review; signing unavailable"},
  {"fork_gobyte", "GBX", "Gobyte", 176, WalletCapabilityAddress, "fork_gobyte", "imported address metadata; no official chainparams review; signing unavailable"},
  {"fork_gridcoin", "GRC", "Gridcoin", 84, WalletCapabilityAddress, "fork_gridcoin", "imported address metadata; no official chainparams review; signing unavailable"},
  {"fork_groestlcoin", "GRS", "Groestlcoin", 17, WalletCapabilityAddress, "fork_groestlcoin", "imported address metadata; no official chainparams review; signing unavailable"},
  {"fork_helleniccoin", "HNC", "Helleniccoin", 168, WalletCapabilityAddress, "fork_helleniccoin", "imported address metadata; no official chainparams review; signing unavailable"},
  {"fork_hempcoin", "THC", "Hempcoin", 113, WalletCapabilityAddress, "fork_hempcoin", "imported address metadata; no official chainparams review; signing unavailable"},
  {"fork_zencash", "ZEN", "Horizen", 121, WalletCapabilityAddress, "fork_zencash", "official chainparams address parameters; signing policy is separate"},
  {"fork_hush", "HUSH", "Hush (Legacy)", 197, WalletCapabilityAddress, "fork_hush", "imported address metadata; no official chainparams review; signing unavailable"},
  {"fork_imagecoin", "IMG", "ImageCoin", 388, WalletCapabilityAddress, "fork_imagecoin", "official chainparams address parameters; signing policy is separate"},
  {"fork_insane", "INSN", "Insane", 68, WalletCapabilityAddress, "fork_insane", "imported address metadata; no official chainparams review; signing unavailable"},
  {"fork_iop", "IOP", "Iop", 66, WalletCapabilityAddress, "fork_iop", "imported address metadata; no official chainparams review; signing unavailable"},
  {"fork_ixcoin", "IXC", "Ixcoin", 86, WalletCapabilityAddress, "fork_ixcoin", "imported address metadata; no official chainparams review; signing unavailable"},
  {"fork_jumbucks", "JBS", "Jumbucks", 26, WalletCapabilityAddress, "fork_jumbucks", "imported address metadata; no official chainparams review; signing unavailable"},
  {"fork_kobocoin", "KOBO", "Kobocoin", 196, WalletCapabilityAddress, "fork_kobocoin", "imported address metadata; no official chainparams review; signing unavailable"},
  {"fork_komodo", "KMD", "Komodo", 141, WalletCapabilityAddress, "fork_komodo", "imported address metadata; no official chainparams review; signing unavailable"},
  {"fork_landcoin", "LDCN", "Landcoin", 63, WalletCapabilityAddress, "fork_landcoin", "imported address metadata; no official chainparams review; signing unavailable"},
  {"fork_lbry", "LBC", "Library Credits", 140, WalletCapabilityAddress, "fork_lbry", "imported address metadata; no official chainparams review; signing unavailable"},
  {"fork_linx", "LINX", "Linx", 114, WalletCapabilityAddress, "fork_linx", "imported address metadata; no official chainparams review; signing unavailable"},
  {"fork_litecoincash", "LCC", "Litecoincash", 192, WalletCapabilityAddress, "fork_litecoincash", "imported address metadata; no official chainparams review; signing unavailable"},
  {"fork_litecoinz", "LTZ", "LitecoinZ", 221, WalletCapabilityAddress, "fork_litecoinz", "imported address metadata; no official chainparams review; signing unavailable"},
  {"fork_lkrcoin", "LKR", "Lkrcoin", 557, WalletCapabilityAddress, "fork_lkrcoin", "imported address metadata; no official chainparams review; signing unavailable"},
  {"fork_lynx", "LYNX", "Lynx", 191, WalletCapabilityAddress, "fork_lynx", "imported address metadata; no official chainparams review; signing unavailable"},
  {"fork_maza", "MAZA", "Maza", 13, WalletCapabilityAddress, "fork_maza", "imported address metadata; no official chainparams review; signing unavailable"},
  {"fork_megacoin", "MEC", "Megacoin", 217, WalletCapabilityAddress, "fork_megacoin", "official chainparams address parameters; signing policy is separate"},
  {"fork_megacoin84", "MEC", "Megacoin Native SegWit", 217, WalletCapabilityAddress, "fork_megacoin84", "official chainparams address parameters; signing policy is separate"},
  {"fork_megacoin49", "MEC", "Megacoin Nested SegWit", 217, WalletCapabilityAddress, "fork_megacoin49", "official chainparams address parameters; signing policy is separate"},
  {"fork_minexcoin", "MNX", "Minexcoin", 182, WalletCapabilityAddress, "fork_minexcoin", "imported address metadata; no official chainparams review; signing unavailable"},
  {"fork_moirai", "MOI", "Moirai", 6174, WalletCapabilityAddress, "fork_moirai", "official chainparams address parameters; signing policy is separate"},
  {"fork_monacoin", "MONA", "Monacoin", 22, WalletCapabilityAddress, "fork_monacoin", "imported address metadata; no official chainparams review; signing unavailable"},
  {"fork_monkeyproject", "MONK", "Monkey Project", 214, WalletCapabilityAddress, "fork_monkeyproject", "imported address metadata; no official chainparams review; signing unavailable"},
  {"fork_myriadcoin", "XMY", "Myriadcoin", 90, WalletCapabilityAddress, "fork_myriadcoin", "imported address metadata; no official chainparams review; signing unavailable"},
  {"fork_navcoin", "NAV", "Navcoin", 130, WalletCapabilityAddress, "fork_navcoin", "imported address metadata; no official chainparams review; signing unavailable"},
  {"fork_neblio", "NEBL", "Neblio", 146, WalletCapabilityAddress, "fork_neblio", "imported address metadata; no official chainparams review; signing unavailable"},
  {"fork_neoscoin", "NEOS", "Neoscoin", 25, WalletCapabilityAddress, "fork_neoscoin", "imported address metadata; no official chainparams review; signing unavailable"},
  {"fork_netsis", "NET", "Netsis", 693, WalletCapabilityAddress, "fork_netsis", "official chainparams address parameters; signing policy is separate"},
  {"fork_neurocoin", "NRO", "Neurocoin", 110, WalletCapabilityAddress, "fork_neurocoin", "imported address metadata; no official chainparams review; signing unavailable"},
  {"fork_newyorkc", "NYC", "Newyorkc", 179, WalletCapabilityAddress, "fork_newyorkc", "imported address metadata; no official chainparams review; signing unavailable"},
  {"fork_nix", "NIX", "NIX Platform", 400, WalletCapabilityAddress, "fork_nix", "imported address metadata; no official chainparams review; signing unavailable"},
  {"fork_novacoin", "NVC", "Novacoin", 50, WalletCapabilityAddress, "fork_novacoin", "imported address metadata; no official chainparams review; signing unavailable"},
  {"fork_novo", "NOVO", "Novo", 530, WalletCapabilityAddress, "fork_novo", "official chainparams address parameters; signing policy is separate"},
  {"fork_nubits", "USNBT", "NuBits", 12, WalletCapabilityAddress, "fork_nubits", "imported address metadata; no official chainparams review; signing unavailable"},
  {"fork_nushares", "NSR", "Nushares", 11, WalletCapabilityAddress, "fork_nushares", "imported address metadata; no official chainparams review; signing unavailable"},
  {"fork_okcash", "OK", "Okcash", 69, WalletCapabilityAddress, "fork_okcash", "imported address metadata; no official chainparams review; signing unavailable"},
  {"fork_omnicore", "OMNI", "Omnicore", 200, WalletCapabilityAddress, "fork_omnicore", "imported address metadata; no official chainparams review; signing unavailable"},
  {"fork_onixcoin", "ONX", "Onixcoin", 174, WalletCapabilityAddress, "fork_onixcoin", "imported address metadata; no official chainparams review; signing unavailable"},
  {"fork_particl", "PART", "Particl", 44, WalletCapabilityAddress, "fork_particl", "imported address metadata; no official chainparams review; signing unavailable"},
  {"fork_pesobit", "PSB", "Pesobit", 62, WalletCapabilityAddress, "fork_pesobit", "imported address metadata; no official chainparams review; signing unavailable"},
  {"fork_phore", "PHR", "Phore", 444, WalletCapabilityAddress, "fork_phore", "imported address metadata; no official chainparams review; signing unavailable"},
  {"fork_pinkcoin", "PINK", "Pinkcoin", 117, WalletCapabilityAddress, "fork_pinkcoin", "imported address metadata; no official chainparams review; signing unavailable"},
  {"fork_pivx", "PIVX", "PIVX", 119, WalletCapabilityAddress, "fork_pivx", "imported address metadata; no official chainparams review; signing unavailable"},
  {"fork_poswcoin", "POSW", "POSWcoin", 47, WalletCapabilityAddress, "fork_poswcoin", "imported address metadata; no official chainparams review; signing unavailable"},
  {"fork_potcoin", "POT", "Potcoin", 81, WalletCapabilityAddress, "fork_potcoin", "imported address metadata; no official chainparams review; signing unavailable"},
  {"fork_projectcoin", "PRJ", "ProjectCoin", 533, WalletCapabilityAddress, "fork_projectcoin", "imported address metadata; no official chainparams review; signing unavailable"},
  {"fork_putincoin", "PUT", "Putincoin", 122, WalletCapabilityAddress, "fork_putincoin", "imported address metadata; no official chainparams review; signing unavailable"},
  {"fork_rapids", "RPD", "Rapids", 320, WalletCapabilityAddress, "fork_rapids", "imported address metadata; no official chainparams review; signing unavailable"},
  {"fork_ravencoinclassic", "RVC", "Ravencoin Classic", 175, WalletCapabilityAddress, "fork_ravencoinclassic", "official chainparams address parameters; signing policy is separate"},
  {"fork_ravencoinclassic49", "RVC", "Ravencoin Classic Nested SegWit", 175, WalletCapabilityAddress, "fork_ravencoinclassic49", "official chainparams address parameters; signing policy is separate"},
  {"fork_reddcoin", "RDD", "Reddcoin", 4, WalletCapabilityAddress, "fork_reddcoin", "imported address metadata; no official chainparams review; signing unavailable"},
  {"fork_revolutionvr", "RVR", "RevolutionVR", 129, WalletCapabilityAddress, "fork_revolutionvr", "imported address metadata; no official chainparams review; signing unavailable"},
  {"fork_ritocoin", "RITO", "Ritocoin", 19169, WalletCapabilityAddress, "fork_ritocoin", "imported address metadata; no official chainparams review; signing unavailable"},
  {"fork_rubycoin", "RBY", "Rubycoin", 16, WalletCapabilityAddress, "fork_rubycoin", "imported address metadata; no official chainparams review; signing unavailable"},
  {"fork_safecoin", "SAFE", "Safecoin", 19165, WalletCapabilityAddress, "fork_safecoin", "imported address metadata; no official chainparams review; signing unavailable"},
  {"fork_salus", "SLS", "Salus", 63, WalletCapabilityAddress, "fork_salus", "imported address metadata; no official chainparams review; signing unavailable"},
  {"fork_scribe", "SCRIBE", "Scribe", 545, WalletCapabilityAddress, "fork_scribe", "imported address metadata; no official chainparams review; signing unavailable"},
  {"fork_shadow", "SDC", "ShadowCash", 35, WalletCapabilityAddress, "fork_shadow", "imported address metadata; no official chainparams review; signing unavailable"},
  {"fork_slimcoin", "SLM", "Slimcoin", 63, WalletCapabilityAddress, "fork_slimcoin", "imported address metadata; no official chainparams review; signing unavailable"},
  {"fork_smileycoin", "SMLY", "Smileycoin", 59, WalletCapabilityAddress, "fork_smileycoin", "imported address metadata; no official chainparams review; signing unavailable"},
  {"fork_solarcoin", "SLR", "Solarcoin", 58, WalletCapabilityAddress, "fork_solarcoin", "imported address metadata; no official chainparams review; signing unavailable"},
  {"fork_stash", "STASH", "Stash", 0, WalletCapabilityAddress, "fork_stash", "imported address metadata; no official chainparams review; signing unavailable"},
  {"fork_stratis", "STRAT", "Stratis", 105, WalletCapabilityAddress, "fork_stratis", "imported address metadata; no official chainparams review; signing unavailable"},
  {"fork_sugarchain", "SUGAR", "Sugarchain", 408, WalletCapabilityAddress, "fork_sugarchain", "official chainparams address parameters; signing policy is separate"},
  {"fork_sugarchain84", "SUGAR", "Sugarchain Native SegWit", 408, WalletCapabilityAddress, "fork_sugarchain84", "official chainparams address parameters; signing policy is separate"},
  {"fork_sugarchain49", "SUGAR", "Sugarchain Nested SegWit", 408, WalletCapabilityAddress, "fork_sugarchain49", "official chainparams address parameters; signing policy is separate"},
  {"fork_syscoin", "SYS", "Syscoin", 57, WalletCapabilityAddress, "fork_syscoin", "imported address metadata; no official chainparams review; signing unavailable"},
  {"fork_thought", "THT", "Thought", 1618, WalletCapabilityAddress, "fork_thought", "imported address metadata; no official chainparams review; signing unavailable"},
  {"fork_toa", "TOA", "Toa", 159, WalletCapabilityAddress, "fork_toa", "imported address metadata; no official chainparams review; signing unavailable"},
  {"fork_twins", "TWINS", "TWINS", 970, WalletCapabilityAddress, "fork_twins", "imported address metadata; no official chainparams review; signing unavailable"},
  {"fork_ultimatesecurecash", "USC", "Ultimatesecurecash", 112, WalletCapabilityAddress, "fork_ultimatesecurecash", "imported address metadata; no official chainparams review; signing unavailable"},
  {"fork_unobtanium", "UNO", "Unobtanium", 92, WalletCapabilityAddress, "fork_unobtanium", "imported address metadata; no official chainparams review; signing unavailable"},
  {"fork_vcash", "XVC", "Vcash", 127, WalletCapabilityAddress, "fork_vcash", "imported address metadata; no official chainparams review; signing unavailable"},
  {"fork_verge", "XVG", "Verge", 77, WalletCapabilityAddress, "fork_verge", "imported address metadata; no official chainparams review; signing unavailable"},
  {"fork_viacoin", "VIA", "Viacoin", 14, WalletCapabilityAddress, "fork_viacoin", "imported address metadata; no official chainparams review; signing unavailable"},
  {"fork_vivo", "VIVO", "Vivo", 166, WalletCapabilityAddress, "fork_vivo", "imported address metadata; no official chainparams review; signing unavailable"},
  {"fork_vpncoin", "VASH", "Vpncoin", 33, WalletCapabilityAddress, "fork_vpncoin", "imported address metadata; no official chainparams review; signing unavailable"},
  {"fork_wagerr", "WGR", "Wagerr", 7825266, WalletCapabilityAddress, "fork_wagerr", "imported address metadata; no official chainparams review; signing unavailable"},
  {"fork_whitecoin", "XWCC", "Whitecoin Classic", 155, WalletCapabilityAddress, "fork_whitecoin", "imported address metadata; no official chainparams review; signing unavailable"},
  {"fork_wincoin", "WC", "Wincoin", 181, WalletCapabilityAddress, "fork_wincoin", "imported address metadata; no official chainparams review; signing unavailable"},
  {"fork_xuez", "XUEZ", "Xuez", 225, WalletCapabilityAddress, "fork_xuez", "imported address metadata; no official chainparams review; signing unavailable"},
  {"fork_zclassic", "ZCL", "Zclassic", 147, WalletCapabilityAddress, "fork_zclassic", "imported address metadata; no official chainparams review; signing unavailable"},
  {"fork_zcoin", "XZC", "Zcoin (rebranded to Firo)", 136, WalletCapabilityAddress, "fork_zcoin", "imported address metadata; no official chainparams review; signing unavailable"},
