// Generated by tools/generate_fork_profiles.py from tools/fork_registry.json.
// Base parameters imported from iancoleman/bip39; rows carrying a source
// field were cross-checked against the official chainparams.cpp. Native
// SegWit requires an official bech32 HRP; nested SegWit requires explicit
// segwit metadata from the same source.
// Sorted by chain name A-Z.
  {"fork_adcoin", "ACC", "Adcoin", 161, 161, 44, DerivationStyle::Bip44, AddressEncoding::P2pkh, {0x17, 0x05, nullptr, false}, 0, 0, 0x0000, 0x0000, nullptr},
  {"fork_anon", "ANON", "ANON", 220, 220, 44, DerivationStyle::Bip44, AddressEncoding::ZcashTransparent, {0, 0, nullptr, false}, 0, 0, 0x0582, 0x5389, nullptr},
  {"fork_argentum-lyra", "ARG", "Argentum", 45, 45, 44, DerivationStyle::Bip44, AddressEncoding::P2pkh, {0x17, 0x05, nullptr, false}, 0, 0, 0x0000, 0x0000, nullptr},
  {"fork_argoneum", "AGM", "Argoneum", 421, 421, 44, DerivationStyle::Bip44, AddressEncoding::P2pkh, {0x32, 0x61, nullptr, false}, 0, 0, 0x0000, 0x0000, nullptr},
  {"fork_artax", "XAX", "Artax", 219, 219, 44, DerivationStyle::Bip44, AddressEncoding::P2pkh, {0x17, 0xbd, nullptr, false}, 0, 0, 0x0000, 0x0000, nullptr},
  {"fork_aryacoin", "ARYA", "Aryacoin", 357, 357, 44, DerivationStyle::Bip44, AddressEncoding::P2pkh, {0x17, 0x6f, nullptr, false}, 0, 0, 0x0000, 0x0000, nullptr},
  {"fork_asiacoin", "AC", "Asiacoin", 51, 51, 44, DerivationStyle::Bip44, AddressEncoding::P2pkh, {0x17, 0x08, nullptr, false}, 0, 0, 0x0000, 0x0000, nullptr},
  {"fork_auroracoin", "AUR", "Auroracoin", 85, 85, 44, DerivationStyle::Bip44, AddressEncoding::P2pkh, {0x17, 0x05, nullptr, false}, 0, 0, 0x0000, 0x0000, nullptr},
  {"fork_aurumcoin", "AU", "AurumCoin", 985, 985, 44, DerivationStyle::Bip44, AddressEncoding::P2pkh, {0x00, 0x05, nullptr, false}, 0, 0, 0x0000, 0x0000, nullptr},
  {"fork_bata", "BTA", "Bata", 89, 89, 44, DerivationStyle::Bip44, AddressEncoding::P2pkh, {0x19, 0x05, nullptr, false}, 0, 0, 0x0000, 0x0000, nullptr},
  {"fork_beetlecoin", "BEET", "Beetlecoin", 800, 800, 44, DerivationStyle::Bip44, AddressEncoding::P2pkh, {0x1a, 0x55, nullptr, false}, 0, 0, 0x0000, 0x0000, nullptr},
  {"fork_belacoin", "BELA", "Belacoin", 73, 73, 44, DerivationStyle::Bip44, AddressEncoding::P2pkh, {0x19, 0x05, nullptr, false}, 0, 0, 0x0000, 0x0000, nullptr},
  {"fork_bitcloud", "BTDX", "BitCloud", 218, 218, 44, DerivationStyle::Bip44, AddressEncoding::P2pkh, {0x19, 0x05, nullptr, false}, 0, 0, 0x0000, 0x0000, nullptr},
  {"fork_bitcoindiamond", "BCD", "Bitcoin Diamond", 999, 999, 44, DerivationStyle::Bip44, AddressEncoding::P2pkh, {0x00, 0x05, nullptr, false}, 0, 0, 0x0000, 0x0000, nullptr},
  {"fork_bitcoingreen", "BITG", "Bitcoin Green", 222, 222, 44, DerivationStyle::Bip44, AddressEncoding::P2pkh, {0x26, 0xbd, nullptr, false}, 0, 0, 0x0000, 0x0000, nullptr},
  {"fork_bitcoinprivate", "BTCP", "Bitcoin Private", 183, 183, 44, DerivationStyle::Bip44, AddressEncoding::ZcashTransparent, {0, 0, nullptr, false}, 0, 0, 0x1325, 0x13af, nullptr},
  {"fork_bitcoinplus", "XBC", "Bitcoinplus", 65, 65, 44, DerivationStyle::Bip44, AddressEncoding::P2pkh, {0x19, 0x08, nullptr, false}, 0, 0, 0x0000, 0x0000, nullptr},
  {"fork_bitcoinz", "BTCZ", "Bitcoinz", 177, 177, 44, DerivationStyle::Bip44, AddressEncoding::ZcashTransparent, {0, 0, nullptr, false}, 0, 0, 0x1cb8, 0x1cbd, nullptr},
  {"fork_bitcore", "BTX", "Bitcore", 160, 160, 44, DerivationStyle::Bip44, AddressEncoding::P2pkh, {0x03, 0x7d, nullptr, false}, 0, 0, 0x0000, 0x0000, nullptr},
  {"fork_bitsend", "BSD", "Bitsend", 91, 91, 44, DerivationStyle::Bip44, AddressEncoding::P2pkh, {0x66, 0x05, nullptr, false}, 0, 0, 0x0000, 0x0000, nullptr},
  {"fork_blackcoin", "BLK", "BlackCoin", 10, 10, 44, DerivationStyle::Bip44, AddressEncoding::P2pkh, {0x19, 0x55, nullptr, false}, 0, 0, 0x0000, 0x0000, nullptr},
  {"fork_blocknode", "BND", "Blocknode", 2941, 2941, 44, DerivationStyle::Bip44, AddressEncoding::P2pkh, {0x19, 0x3f, nullptr, false}, 0, 0, 0x0000, 0x0000, nullptr},
  {"fork_blockstamp", "BST", "BlockStamp", 254, 254, 44, DerivationStyle::Bip44, AddressEncoding::P2pkh, {0x00, 0x05, nullptr, false}, 0, 0, 0x0000, 0x0000, nullptr},
  {"fork_bolivarcoin", "BOLI", "Bolivarcoin", 278, 278, 44, DerivationStyle::Bip44, AddressEncoding::P2pkh, {0x55, 0x05, nullptr, false}, 0, 0, 0x0000, 0x0000, nullptr},
  {"fork_britcoin", "BRIT", "Britcoin", 70, 70, 44, DerivationStyle::Bip44, AddressEncoding::P2pkh, {0x19, 0x55, nullptr, false}, 0, 0, 0x0000, 0x0000, nullptr},
  {"fork_c0ban", "RYO", "c0ban", 382, 382, 44, DerivationStyle::Bip44, AddressEncoding::P2pkh, {0x12, 0x1c, nullptr, false}, 0, 0, 0x0000, 0x0000, nullptr},
  {"fork_campuscoin", "CC", "CampusCoin", 6767, 6767, 44, DerivationStyle::Bip44, AddressEncoding::P2pkh, {0x1c, 0x05, nullptr, false}, 0, 0, 0x0000, 0x0000, nullptr},
  {"fork_canadaecoin", "CDN", "Canadaecoin", 34, 34, 44, DerivationStyle::Bip44, AddressEncoding::P2pkh, {0x1c, 0x05, nullptr, false}, 0, 0, 0x0000, 0x0000, nullptr},
  {"fork_cannacoin", "CCN", "Cannacoin", 19, 19, 44, DerivationStyle::Bip44, AddressEncoding::P2pkh, {0x1c, 0x05, nullptr, false}, 0, 0, 0x0000, 0x0000, nullptr},
  {"fork_ceilingcat", "CCC", "CeilingCatCoin", 702, 702, 44, DerivationStyle::Bip44, AddressEncoding::P2pkh, {0x1c, 0x1e, nullptr, false}, 0, 0, 0x0000, 0x0000, nullptr},
  {"fork_clam", "CLAM", "Clams", 23, 23, 44, DerivationStyle::Bip44, AddressEncoding::P2pkh, {0x89, 0x0d, nullptr, false}, 0, 0, 0x0000, 0x0000, nullptr},
  {"fork_clubcoin", "CLUB", "Clubcoin", 79, 79, 44, DerivationStyle::Bip44, AddressEncoding::P2pkh, {0x1c, 0x55, nullptr, false}, 0, 0, 0x0000, 0x0000, nullptr},
  {"fork_compcoin", "CMP", "Compcoin", 71, 71, 44, DerivationStyle::Bip44, AddressEncoding::P2pkh, {0x1c, 0x55, nullptr, false}, 0, 0, 0x0000, 0x0000, nullptr},
  {"fork_cpuchain", "CPU", "CPUchain", 363, 363, 44, DerivationStyle::Bip44, AddressEncoding::P2pkh, {0x1c, 0x1e, nullptr, false}, 0, 0, 0x0000, 0x0000, nullptr},
  {"fork_cranepay", "CRP", "CranePay", 2304, 2304, 44, DerivationStyle::Bip44, AddressEncoding::P2pkh, {0x1c, 0x0a, nullptr, false}, 0, 0, 0x0000, 0x0000, nullptr},
  {"fork_crave", "CRAVE", "Crave", 186, 186, 44, DerivationStyle::Bip44, AddressEncoding::P2pkh, {0x46, 0x55, nullptr, false}, 0, 0, 0x0000, 0x0000, nullptr},
  {"fork_crown", "CRW", "Crown (Legacy)", 72, 72, 44, DerivationStyle::Bip44, AddressEncoding::P2pkh, {0x00, 0x05, nullptr, false}, 0, 0, 0x0000, 0x0000, nullptr},
  {"fork_deeponion", "ONION", "DeepOnion", 305, 305, 44, DerivationStyle::Bip44, AddressEncoding::P2pkh, {0x1f, 0x4e, nullptr, false}, 0, 0, 0x0000, 0x0000, nullptr},
  {"fork_defcoin", "DFC", "Defcoin", 1337, 1337, 44, DerivationStyle::Bip44, AddressEncoding::P2pkh, {0x1e, 0x05, nullptr, false}, 0, 0, 0x0000, 0x0000, nullptr},
  {"fork_denarius", "DNR", "Denarius", 116, 116, 44, DerivationStyle::Bip44, AddressEncoding::P2pkh, {0x1e, 0x5a, nullptr, false}, 0, 0, 0x0000, 0x0000, nullptr},
  {"fork_diamond", "DMD", "Diamond", 152, 152, 44, DerivationStyle::Bip44, AddressEncoding::P2pkh, {0x5a, 0x08, nullptr, false}, 0, 0, 0x0000, 0x0000, nullptr},
  {"fork_digitalcoin", "DGC", "Digitalcoin", 18, 18, 44, DerivationStyle::Bip44, AddressEncoding::P2pkh, {0x1e, 0x05, nullptr, false}, 0, 0, 0x0000, 0x0000, nullptr},
  {"fork_divi", "DIVI", "DIVI", 301, 301, 44, DerivationStyle::Bip44, AddressEncoding::P2pkh, {0x1e, 0x0d, nullptr, false}, 0, 0, 0x0000, 0x0000, nullptr},
  {"fork_ecoin", "ECN", "Ecoin", 115, 115, 44, DerivationStyle::Bip44, AddressEncoding::P2pkh, {0x5c, 0x14, nullptr, false}, 0, 0, 0x0000, 0x0000, nullptr},
  {"fork_edrcoin", "EDRC", "Edrcoin", 56, 56, 44, DerivationStyle::Bip44, AddressEncoding::P2pkh, {0x5d, 0x1c, nullptr, false}, 0, 0, 0x0000, 0x0000, nullptr},
  {"fork_egulden", "EFL", "Egulden", 78, 78, 44, DerivationStyle::Bip44, AddressEncoding::P2pkh, {0x30, 0x05, nullptr, false}, 0, 0, 0x0000, 0x0000, nullptr},
  {"fork_einsteinium", "EMC2", "Einsteinium", 41, 41, 44, DerivationStyle::Bip44, AddressEncoding::P2pkh, {0x21, 0x05, nullptr, false}, 0, 0, 0x0000, 0x0000, nullptr},
  {"fork_elastos", "ELA", "Elastos", 2305, 2305, 44, DerivationStyle::Bip44, AddressEncoding::P2pkh, {0x21, 0xc4, nullptr, false}, 0, 0, 0x0000, 0x0000, nullptr},
  {"fork_energi", "NRG", "Energi", 204, 204, 44, DerivationStyle::Bip44, AddressEncoding::P2pkh, {0x21, 0x35, nullptr, false}, 0, 0, 0x0000, 0x0000, nullptr},
  {"fork_europecoin", "ERC", "Europecoin", 151, 151, 44, DerivationStyle::Bip44, AddressEncoding::P2pkh, {0x21, 0x05, nullptr, false}, 0, 0, 0x0000, 0x0000, nullptr},
  {"fork_evoai", "EVO", "EvoAI", 98, 98, 44, DerivationStyle::Bip44, AddressEncoding::P2pkh, {0x21, 0x05, nullptr, false}, 0, 0, 0x0000, 0x0000, nullptr},
  {"fork_evoai84", "EVO", "EvoAI Native SegWit", 98, 98, 84, DerivationStyle::Bip44, AddressEncoding::P2wpkh, {0x21, 0x05, "evo", false}, 0, 0, 0, 0, nullptr},
  {"fork_evoai49", "EVO", "EvoAI Nested SegWit", 98, 98, 49, DerivationStyle::Bip44, AddressEncoding::P2shP2wpkh, {0x21, 0x05, nullptr, false}, 0, 0, 0, 0, nullptr},
  {"fork_exclusivecoin", "EXCL", "Exclusivecoin", 190, 190, 44, DerivationStyle::Bip44, AddressEncoding::P2pkh, {0x21, 0x89, nullptr, false}, 0, 0, 0x0000, 0x0000, nullptr},
  {"fork_feathercoin", "FTC", "Feathercoin", 8, 8, 44, DerivationStyle::Bip44, AddressEncoding::P2pkh, {0x0e, 0x05, nullptr, false}, 0, 0, 0x0000, 0x0000, nullptr},
  {"fork_firo", "FIRO", "Firo (Zcoin rebrand)", 136, 136, 44, DerivationStyle::Bip44, AddressEncoding::P2pkh, {0x52, 0x07, nullptr, false}, 0, 0, 0x0000, 0x0000, nullptr},
  {"fork_firstcoin", "FRST", "Firstcoin", 167, 167, 44, DerivationStyle::Bip44, AddressEncoding::P2pkh, {0x23, 0x05, nullptr, false}, 0, 0, 0x0000, 0x0000, nullptr},
  {"fork_fix", "FIX", "FIX", 336, 336, 44, DerivationStyle::Bip44, AddressEncoding::P2pkh, {0x23, 0x5f, nullptr, false}, 0, 0, 0x0000, 0x0000, nullptr},
  {"fork_flashcoin", "FLASH", "Flashcoin", 120, 120, 44, DerivationStyle::Bip44, AddressEncoding::P2pkh, {0x44, 0x82, nullptr, false}, 0, 0, 0x0000, 0x0000, nullptr},
  {"fork_fujicoin", "FJC", "Fujicoin", 75, 75, 44, DerivationStyle::Bip44, AddressEncoding::P2pkh, {0x24, 0x10, nullptr, false}, 0, 0, 0x0000, 0x0000, nullptr},
  {"fork_game", "GAME", "GameCredits", 101, 101, 44, DerivationStyle::Bip44, AddressEncoding::P2pkh, {0x26, 0x05, nullptr, false}, 0, 0, 0x0000, 0x0000, nullptr},
  {"fork_gcr", "GCR", "GCRCoin", 79, 79, 44, DerivationStyle::Bip44, AddressEncoding::P2pkh, {0x26, 0x61, nullptr, false}, 0, 0, 0x0000, 0x0000, nullptr},
  {"fork_gobyte", "GBX", "Gobyte", 176, 176, 44, DerivationStyle::Bip44, AddressEncoding::P2pkh, {0x26, 0x0a, nullptr, false}, 0, 0, 0x0000, 0x0000, nullptr},
  {"fork_gridcoin", "GRC", "Gridcoin", 84, 84, 44, DerivationStyle::Bip44, AddressEncoding::P2pkh, {0x3e, 0x55, nullptr, false}, 0, 0, 0x0000, 0x0000, nullptr},
  {"fork_groestlcoin", "GRS", "Groestlcoin", 17, 17, 44, DerivationStyle::Bip44, AddressEncoding::P2pkh, {0x24, 0x05, nullptr, false}, 0, 0, 0x0000, 0x0000, nullptr},
  {"fork_helleniccoin", "HNC", "Helleniccoin", 168, 168, 44, DerivationStyle::Bip44, AddressEncoding::P2pkh, {0x30, 0x05, nullptr, false}, 0, 0, 0x0000, 0x0000, nullptr},
  {"fork_hempcoin", "THC", "Hempcoin", 113, 113, 44, DerivationStyle::Bip44, AddressEncoding::P2pkh, {0x28, 0x08, nullptr, false}, 0, 0, 0x0000, 0x0000, nullptr},
  {"fork_zencash", "ZEN", "Horizen", 121, 121, 44, DerivationStyle::Bip44, AddressEncoding::ZcashTransparent, {0, 0, nullptr, false}, 0, 0, 0x2089, 0x2096, nullptr},
  {"fork_hush", "HUSH", "Hush (Legacy)", 197, 197, 44, DerivationStyle::Bip44, AddressEncoding::ZcashTransparent, {0, 0, nullptr, false}, 0, 0, 0x1cb8, 0x1cbd, nullptr},
  {"fork_imagecoin", "IMG", "ImageCoin", 388, 388, 44, DerivationStyle::Bip44, AddressEncoding::P2pkh, {0x33, 0x10, nullptr, false}, 0, 0, 0x0000, 0x0000, nullptr},
  {"fork_insane", "INSN", "Insane", 68, 68, 44, DerivationStyle::Bip44, AddressEncoding::P2pkh, {0x66, 0x39, nullptr, false}, 0, 0, 0x0000, 0x0000, nullptr},
  {"fork_iop", "IOP", "Iop", 66, 66, 44, DerivationStyle::Bip44, AddressEncoding::P2pkh, {0x75, 0xae, nullptr, false}, 0, 0, 0x0000, 0x0000, nullptr},
  {"fork_ixcoin", "IXC", "Ixcoin", 86, 86, 44, DerivationStyle::Bip44, AddressEncoding::P2pkh, {0x8a, 0x05, nullptr, false}, 0, 0, 0x0000, 0x0000, nullptr},
  {"fork_jumbucks", "JBS", "Jumbucks", 26, 26, 44, DerivationStyle::Bip44, AddressEncoding::P2pkh, {0x2b, 0x05, nullptr, false}, 0, 0, 0x0000, 0x0000, nullptr},
  {"fork_kobocoin", "KOBO", "Kobocoin", 196, 196, 44, DerivationStyle::Bip44, AddressEncoding::P2pkh, {0x23, 0x1c, nullptr, false}, 0, 0, 0x0000, 0x0000, nullptr},
  {"fork_komodo", "KMD", "Komodo", 141, 141, 44, DerivationStyle::Bip44, AddressEncoding::P2pkh, {0x3c, 0x55, nullptr, false}, 0, 0, 0x0000, 0x0000, nullptr},
  {"fork_landcoin", "LDCN", "Landcoin", 63, 63, 44, DerivationStyle::Bip44, AddressEncoding::P2pkh, {0x30, 0x7a, nullptr, false}, 0, 0, 0x0000, 0x0000, nullptr},
  {"fork_lbry", "LBC", "Library Credits", 140, 140, 44, DerivationStyle::Bip44, AddressEncoding::P2pkh, {0x55, 0x7a, nullptr, false}, 0, 0, 0x0000, 0x0000, nullptr},
  {"fork_linx", "LINX", "Linx", 114, 114, 44, DerivationStyle::Bip44, AddressEncoding::P2pkh, {0x4b, 0x05, nullptr, false}, 0, 0, 0x0000, 0x0000, nullptr},
  {"fork_litecoincash", "LCC", "Litecoincash", 192, 192, 44, DerivationStyle::Bip44, AddressEncoding::P2pkh, {0x1c, 0x05, nullptr, false}, 0, 0, 0x0000, 0x0000, nullptr},
  {"fork_litecoinz", "LTZ", "LitecoinZ", 221, 221, 44, DerivationStyle::Bip44, AddressEncoding::ZcashTransparent, {0, 0, nullptr, false}, 0, 0, 0x0ab3, 0x0ab8, nullptr},
  {"fork_lkrcoin", "LKR", "Lkrcoin", 557, 557, 44, DerivationStyle::Bip44, AddressEncoding::P2pkh, {0x30, 0x55, nullptr, false}, 0, 0, 0x0000, 0x0000, nullptr},
  {"fork_lynx", "LYNX", "Lynx", 191, 191, 44, DerivationStyle::Bip44, AddressEncoding::P2pkh, {0x2d, 0x32, nullptr, false}, 0, 0, 0x0000, 0x0000, nullptr},
  {"fork_maza", "MAZA", "Maza", 13, 13, 44, DerivationStyle::Bip44, AddressEncoding::P2pkh, {0x32, 0x09, nullptr, false}, 0, 0, 0x0000, 0x0000, nullptr},
  {"fork_megacoin", "MEC", "Megacoin", 217, 217, 44, DerivationStyle::Bip44, AddressEncoding::P2pkh, {0x32, 0x05, nullptr, false}, 0, 0, 0x0000, 0x0000, nullptr},
  {"fork_megacoin84", "MEC", "Megacoin Native SegWit", 217, 217, 84, DerivationStyle::Bip44, AddressEncoding::P2wpkh, {0x32, 0x05, "mec", false}, 0, 0, 0, 0, nullptr},
  {"fork_megacoin49", "MEC", "Megacoin Nested SegWit", 217, 217, 49, DerivationStyle::Bip44, AddressEncoding::P2shP2wpkh, {0x32, 0x05, nullptr, false}, 0, 0, 0, 0, nullptr},
  {"fork_minexcoin", "MNX", "Minexcoin", 182, 182, 44, DerivationStyle::Bip44, AddressEncoding::P2pkh, {0x4b, 0x05, nullptr, false}, 0, 0, 0x0000, 0x0000, nullptr},
  {"fork_moirai", "MOI", "Moirai", 6174, 6174, 44, DerivationStyle::Bip44, AddressEncoding::P2pkh, {0x33, 0xc4, nullptr, false}, 0, 0, 0x0000, 0x0000, nullptr},
  {"fork_monacoin", "MONA", "Monacoin", 22, 22, 44, DerivationStyle::Bip44, AddressEncoding::P2pkh, {0x32, 0x37, nullptr, false}, 0, 0, 0x0000, 0x0000, nullptr},
  {"fork_monkeyproject", "MONK", "Monkey Project", 214, 214, 44, DerivationStyle::Bip44, AddressEncoding::P2pkh, {0x33, 0x1c, nullptr, false}, 0, 0, 0x0000, 0x0000, nullptr},
  {"fork_myriadcoin", "XMY", "Myriadcoin", 90, 90, 44, DerivationStyle::Bip44, AddressEncoding::P2pkh, {0x32, 0x09, nullptr, false}, 0, 0, 0x0000, 0x0000, nullptr},
  {"fork_navcoin", "NAV", "Navcoin", 130, 130, 44, DerivationStyle::Bip44, AddressEncoding::P2pkh, {0x35, 0x55, nullptr, false}, 0, 0, 0x0000, 0x0000, nullptr},
  {"fork_neblio", "NEBL", "Neblio", 146, 146, 44, DerivationStyle::Bip44, AddressEncoding::P2pkh, {0x35, 0x70, nullptr, false}, 0, 0, 0x0000, 0x0000, nullptr},
  {"fork_neoscoin", "NEOS", "Neoscoin", 25, 25, 44, DerivationStyle::Bip44, AddressEncoding::P2pkh, {0x35, 0x05, nullptr, false}, 0, 0, 0x0000, 0x0000, nullptr},
  {"fork_netsis", "NET", "Netsis", 693, 693, 44, DerivationStyle::Bip44, AddressEncoding::P2pkh, {0x35, 0x36, nullptr, false}, 0, 0, 0x0000, 0x0000, nullptr},
  {"fork_neurocoin", "NRO", "Neurocoin", 110, 110, 44, DerivationStyle::Bip44, AddressEncoding::P2pkh, {0x35, 0x75, nullptr, false}, 0, 0, 0x0000, 0x0000, nullptr},
  {"fork_newyorkc", "NYC", "Newyorkc", 179, 179, 44, DerivationStyle::Bip44, AddressEncoding::P2pkh, {0x3c, 0x16, nullptr, false}, 0, 0, 0x0000, 0x0000, nullptr},
  {"fork_nix", "NIX", "NIX Platform", 400, 400, 44, DerivationStyle::Bip44, AddressEncoding::P2pkh, {0x26, 0x35, nullptr, false}, 0, 0, 0x0000, 0x0000, nullptr},
  {"fork_novacoin", "NVC", "Novacoin", 50, 50, 44, DerivationStyle::Bip44, AddressEncoding::P2pkh, {0x08, 0x14, nullptr, false}, 0, 0, 0x0000, 0x0000, nullptr},
  {"fork_novo", "NOVO", "Novo", 530, 530, 44, DerivationStyle::Bip44, AddressEncoding::P2pkh, {0x00, 0x05, nullptr, false}, 0, 0, 0x0000, 0x0000, nullptr},
  {"fork_nubits", "USNBT", "NuBits", 12, 12, 44, DerivationStyle::Bip44, AddressEncoding::P2pkh, {0x19, 0x1a, nullptr, false}, 0, 0, 0x0000, 0x0000, nullptr},
  {"fork_nushares", "NSR", "Nushares", 11, 11, 44, DerivationStyle::Bip44, AddressEncoding::P2pkh, {0x3f, 0x40, nullptr, false}, 0, 0, 0x0000, 0x0000, nullptr},
  {"fork_okcash", "OK", "Okcash", 69, 69, 44, DerivationStyle::Bip44, AddressEncoding::P2pkh, {0x37, 0x1c, nullptr, false}, 0, 0, 0x0000, 0x0000, nullptr},
  {"fork_omnicore", "OMNI", "Omnicore", 200, 200, 44, DerivationStyle::Bip44, AddressEncoding::P2pkh, {0x00, 0x05, nullptr, false}, 0, 0, 0x0000, 0x0000, nullptr},
  {"fork_onixcoin", "ONX", "Onixcoin", 174, 174, 44, DerivationStyle::Bip44, AddressEncoding::P2pkh, {0x4b, 0x05, nullptr, false}, 0, 0, 0x0000, 0x0000, nullptr},
  {"fork_particl", "PART", "Particl", 44, 44, 44, DerivationStyle::Bip44, AddressEncoding::P2pkh, {0x38, 0x3c, nullptr, false}, 0, 0, 0x0000, 0x0000, nullptr},
  {"fork_pesobit", "PSB", "Pesobit", 62, 62, 44, DerivationStyle::Bip44, AddressEncoding::P2pkh, {0x37, 0x55, nullptr, false}, 0, 0, 0x0000, 0x0000, nullptr},
  {"fork_phore", "PHR", "Phore", 444, 444, 44, DerivationStyle::Bip44, AddressEncoding::P2pkh, {0x37, 0x0d, nullptr, false}, 0, 0, 0x0000, 0x0000, nullptr},
  {"fork_pinkcoin", "PINK", "Pinkcoin", 117, 117, 44, DerivationStyle::Bip44, AddressEncoding::P2pkh, {0x03, 0x1c, nullptr, false}, 0, 0, 0x0000, 0x0000, nullptr},
  {"fork_pivx", "PIVX", "PIVX", 119, 119, 44, DerivationStyle::Bip44, AddressEncoding::P2pkh, {0x1e, 0x0d, nullptr, false}, 0, 0, 0x0000, 0x0000, nullptr},
  {"fork_poswcoin", "POSW", "POSWcoin", 47, 47, 44, DerivationStyle::Bip44, AddressEncoding::P2pkh, {0x37, 0x55, nullptr, false}, 0, 0, 0x0000, 0x0000, nullptr},
  {"fork_potcoin", "POT", "Potcoin", 81, 81, 44, DerivationStyle::Bip44, AddressEncoding::P2pkh, {0x37, 0x05, nullptr, false}, 0, 0, 0x0000, 0x0000, nullptr},
  {"fork_projectcoin", "PRJ", "ProjectCoin", 533, 533, 44, DerivationStyle::Bip44, AddressEncoding::P2pkh, {0x37, 0x08, nullptr, false}, 0, 0, 0x0000, 0x0000, nullptr},
  {"fork_putincoin", "PUT", "Putincoin", 122, 122, 44, DerivationStyle::Bip44, AddressEncoding::P2pkh, {0x37, 0x14, nullptr, false}, 0, 0, 0x0000, 0x0000, nullptr},
  {"fork_rapids", "RPD", "Rapids", 320, 320, 44, DerivationStyle::Bip44, AddressEncoding::P2pkh, {0x3d, 0x06, nullptr, false}, 0, 0, 0x0000, 0x0000, nullptr},
  {"fork_ravencoinclassic", "RVC", "Ravencoin Classic", 175, 175, 44, DerivationStyle::Bip44, AddressEncoding::P2pkh, {0x3c, 0x7a, nullptr, false}, 0, 0, 0x0000, 0x0000, nullptr},
  {"fork_ravencoinclassic49", "RVC", "Ravencoin Classic Nested SegWit", 175, 175, 49, DerivationStyle::Bip44, AddressEncoding::P2shP2wpkh, {0x3c, 0x7a, nullptr, false}, 0, 0, 0, 0, nullptr},
  {"fork_reddcoin", "RDD", "Reddcoin", 4, 4, 44, DerivationStyle::Bip44, AddressEncoding::P2pkh, {0x3d, 0x05, nullptr, false}, 0, 0, 0x0000, 0x0000, nullptr},
  {"fork_revolutionvr", "RVR", "RevolutionVR", 129, 129, 44, DerivationStyle::Bip44, AddressEncoding::P2pkh, {0x46, 0x05, nullptr, false}, 0, 0, 0x0000, 0x0000, nullptr},
  {"fork_ritocoin", "RITO", "Ritocoin", 19169, 19169, 44, DerivationStyle::Bip44, AddressEncoding::P2pkh, {0x19, 0x69, nullptr, false}, 0, 0, 0x0000, 0x0000, nullptr},
  {"fork_rubycoin", "RBY", "Rubycoin", 16, 16, 44, DerivationStyle::Bip44, AddressEncoding::P2pkh, {0x3c, 0x55, nullptr, false}, 0, 0, 0x0000, 0x0000, nullptr},
  {"fork_safecoin", "SAFE", "Safecoin", 19165, 19165, 44, DerivationStyle::Bip44, AddressEncoding::P2pkh, {0x3d, 0x56, nullptr, false}, 0, 0, 0x0000, 0x0000, nullptr},
  {"fork_salus", "SLS", "Salus", 63, 63, 44, DerivationStyle::Bip44, AddressEncoding::P2pkh, {0x3f, 0xc4, nullptr, false}, 0, 0, 0x0000, 0x0000, nullptr},
  {"fork_scribe", "SCRIBE", "Scribe", 545, 545, 44, DerivationStyle::Bip44, AddressEncoding::P2pkh, {0x3c, 0x7d, nullptr, false}, 0, 0, 0x0000, 0x0000, nullptr},
  {"fork_shadow", "SDC", "ShadowCash", 35, 35, 44, DerivationStyle::Bip44, AddressEncoding::P2pkh, {0x3f, 0x7d, nullptr, false}, 0, 0, 0x0000, 0x0000, nullptr},
  {"fork_slimcoin", "SLM", "Slimcoin", 63, 63, 44, DerivationStyle::Bip44, AddressEncoding::P2pkh, {0x3f, 0x7d, nullptr, false}, 0, 0, 0x0000, 0x0000, nullptr},
  {"fork_smileycoin", "SMLY", "Smileycoin", 59, 59, 44, DerivationStyle::Bip44, AddressEncoding::P2pkh, {0x19, 0x05, nullptr, false}, 0, 0, 0x0000, 0x0000, nullptr},
  {"fork_solarcoin", "SLR", "Solarcoin", 58, 58, 44, DerivationStyle::Bip44, AddressEncoding::P2pkh, {0x12, 0x05, nullptr, false}, 0, 0, 0x0000, 0x0000, nullptr},
  {"fork_stash", "STASH", "Stash", 0, 0, 44, DerivationStyle::Bip44, AddressEncoding::P2pkh, {0x4c, 0x10, nullptr, false}, 0, 0, 0x0000, 0x0000, nullptr},
  {"fork_stratis", "STRAT", "Stratis", 105, 105, 44, DerivationStyle::Bip44, AddressEncoding::P2pkh, {0x3f, 0x7d, nullptr, false}, 0, 0, 0x0000, 0x0000, nullptr},
  {"fork_sugarchain", "SUGAR", "Sugarchain", 408, 408, 44, DerivationStyle::Bip44, AddressEncoding::P2pkh, {0x3f, 0x7d, nullptr, false}, 0, 0, 0x0000, 0x0000, nullptr},
  {"fork_sugarchain84", "SUGAR", "Sugarchain Native SegWit", 408, 408, 84, DerivationStyle::Bip44, AddressEncoding::P2wpkh, {0x3f, 0x7d, "sugar", false}, 0, 0, 0, 0, nullptr},
  {"fork_sugarchain49", "SUGAR", "Sugarchain Nested SegWit", 408, 408, 49, DerivationStyle::Bip44, AddressEncoding::P2shP2wpkh, {0x3f, 0x7d, nullptr, false}, 0, 0, 0, 0, nullptr},
  {"fork_syscoin", "SYS", "Syscoin", 57, 57, 44, DerivationStyle::Bip44, AddressEncoding::P2pkh, {0x3f, 0x05, nullptr, false}, 0, 0, 0x0000, 0x0000, nullptr},
  {"fork_thought", "THT", "Thought", 1618, 1618, 44, DerivationStyle::Bip44, AddressEncoding::P2pkh, {0x07, 0x09, nullptr, false}, 0, 0, 0x0000, 0x0000, nullptr},
  {"fork_toa", "TOA", "Toa", 159, 159, 44, DerivationStyle::Bip44, AddressEncoding::P2pkh, {0x41, 0x17, nullptr, false}, 0, 0, 0x0000, 0x0000, nullptr},
  {"fork_twins", "TWINS", "TWINS", 970, 970, 44, DerivationStyle::Bip44, AddressEncoding::P2pkh, {0x49, 0x53, nullptr, false}, 0, 0, 0x0000, 0x0000, nullptr},
  {"fork_ultimatesecurecash", "USC", "Ultimatesecurecash", 112, 112, 44, DerivationStyle::Bip44, AddressEncoding::P2pkh, {0x44, 0x7d, nullptr, false}, 0, 0, 0x0000, 0x0000, nullptr},
  {"fork_unobtanium", "UNO", "Unobtanium", 92, 92, 44, DerivationStyle::Bip44, AddressEncoding::P2pkh, {0x82, 0x1e, nullptr, false}, 0, 0, 0x0000, 0x0000, nullptr},
  {"fork_vcash", "XVC", "Vcash", 127, 127, 44, DerivationStyle::Bip44, AddressEncoding::P2pkh, {0x47, 0x08, nullptr, false}, 0, 0, 0x0000, 0x0000, nullptr},
  {"fork_verge", "XVG", "Verge", 77, 77, 44, DerivationStyle::Bip44, AddressEncoding::P2pkh, {0x1e, 0x21, nullptr, false}, 0, 0, 0x0000, 0x0000, nullptr},
  {"fork_viacoin", "VIA", "Viacoin", 14, 14, 44, DerivationStyle::Bip44, AddressEncoding::P2pkh, {0x47, 0x21, nullptr, false}, 0, 0, 0x0000, 0x0000, nullptr},
  {"fork_vivo", "VIVO", "Vivo", 166, 166, 44, DerivationStyle::Bip44, AddressEncoding::P2pkh, {0x46, 0x0a, nullptr, false}, 0, 0, 0x0000, 0x0000, nullptr},
  {"fork_vpncoin", "VASH", "Vpncoin", 33, 33, 44, DerivationStyle::Bip44, AddressEncoding::P2pkh, {0x47, 0x05, nullptr, false}, 0, 0, 0x0000, 0x0000, nullptr},
  {"fork_wagerr", "WGR", "Wagerr", 7825266, 7825266, 44, DerivationStyle::Bip44, AddressEncoding::P2pkh, {0x49, 0x3f, nullptr, false}, 0, 0, 0x0000, 0x0000, nullptr},
  {"fork_whitecoin", "XWCC", "Whitecoin Classic", 155, 155, 44, DerivationStyle::Bip44, AddressEncoding::P2pkh, {0x49, 0x57, nullptr, false}, 0, 0, 0x0000, 0x0000, nullptr},
  {"fork_wincoin", "WC", "Wincoin", 181, 181, 44, DerivationStyle::Bip44, AddressEncoding::P2pkh, {0x49, 0x1c, nullptr, false}, 0, 0, 0x0000, 0x0000, nullptr},
  {"fork_xuez", "XUEZ", "Xuez", 225, 225, 44, DerivationStyle::Bip44, AddressEncoding::P2pkh, {0x4b, 0x12, nullptr, false}, 0, 0, 0x0000, 0x0000, nullptr},
  {"fork_zclassic", "ZCL", "Zclassic", 147, 147, 44, DerivationStyle::Bip44, AddressEncoding::ZcashTransparent, {0, 0, nullptr, false}, 0, 0, 0x1cb8, 0x1cbd, nullptr},
  {"fork_zcoin", "XZC", "Zcoin (rebranded to Firo)", 136, 136, 44, DerivationStyle::Bip44, AddressEncoding::P2pkh, {0x52, 0x07, nullptr, false}, 0, 0, 0x0000, 0x0000, nullptr},
